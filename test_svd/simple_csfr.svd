# ARM_Example register map
Vendor: Infineon; Series: ARMCM3; File version: 1.2
SVD Test for Rust PAC generator
CPU: CM3 r1p0, little endian, MPU, FPU, 3 interrupt priority bits
Registers are 32-bit, read-write, reset 0x0 unless marked. A register's access mark holds for its fields unless they carry their own. Offsets are from the block's base; lines under a group give offsets from that group; [hi:lo] are bit positions; {n}, {i} and the like mark numbered series; 'fields as' and 'values as' point back to an identical list; <NAME> marks a mode.

## Memory map
0x40010000 TIMER size 0x100 — Description of peripheral
{0x50000000+0x1000*n} UART[{n}] (n=0..2) — Test cluster
0x60000000 FOO size 0x100 — Fake peripheral containing registers with names starting with non XID_Start characters that cannot be directly used as Rust identifier names.

## Interrupts
0 TIMER0 (TIMER) — Timer 0 interrupt
2 UartInt (UART[{n}]) — Uart interrupt
3 INT_FOO (FOO) — Foo interrupt

## Further device data
aurixCSFR:
  CPU0 version=100 description=CPU baseAddress=0
    offset=0 size=65472 usage=registers
    registers
      DPR[%s] dim=18 dimIncrement=8 description=DPR addressOffset=49152
        DPRy_L description=CPUx Data Protection Range 0 Lower Bound Register resetvalue={Application Reset:0x0} addressOffset=0 size=32 resetValue=0 resetMask=4294967295
          fields
            LOWBND description=DPRy Lower Boundary Address LOWBND lsb=3 msb=31 access=read-write
        DPRy_U description=CPUx Data Protection Range 0 Upper Bound Register resetvalue={Application Reset:0x0} addressOffset=4 size=32 resetValue=0 resetMask=4294967295
          fields
            UPPBND description=DPRy Upper Boundary Address UPPBND lsb=3 msb=31 access=read-write
      CPR[%s] dim=10 dimIncrement=8 description=CPR addressOffset=53248
        CPRy_L description=CPUx Code Protection Range 0 Lower Bound Register resetvalue={Application Reset:0x0} addressOffset=0 size=32 resetValue=0 resetMask=4294967295
          fields
            LOWBND description=CPRy Lower Boundary Address LOWBND lsb=5 msb=31 access=read-write
        CPRy_U description=CPUx Code Protection Range 0 Upper Bound Register resetvalue={Application Reset:0x0} addressOffset=4 size=32 resetValue=0 resetMask=4294967295
          fields
            UPPBND description=CPR0 m Upper Boundary Address UPPBND lsb=5 msb=31 access=read-write
      TPS description=TPS addressOffset=58368
        CON description=CPUx Temporal Protection System Control Register resetvalue={Application Reset:0x0} addressOffset=0 size=32 resetValue=0 resetMask=4294967295
          fields
            TEXP0 description=Timer0 Expired Flag TEXP0. Set when the corresponding timer expires. Cleared on any write to the TIMER0 register. lsb=0 msb=0 access=read-only
            TEXP1 description=Timer1 Expired Flag TEXP1. Set when the corresponding timer expires. Cleared on any write to the TIMER1 register. lsb=1 msb=1 access=read-only
            TEXP2 description=Timer1 Expired Flag TEXP2. Set when the corresponding timer expires. Cleared on any write to the TIMER1 register. lsb=2 msb=2 access=read-only
            TTRAP description=Temporal Protection Trap TTRAP. If set indicates that a TAE trap has been requested. Any subsequent TAE traps are disabled. A write clears the flag and re enables TAE traps. lsb=16 msb=16 access=read-only
        TIMER[%s] dim=3 dimIncrement=4 description=CPUx Temporal Protection System Timer Register 0 resetvalue={Application Reset:0x0} addressOffset=4 size=32 resetValue=0 resetMask=4294967295
          fields
            Timer description=Temporal Protection Timer Timer. Writing zero de activates the Timer. Writing a non zero value starts the Timer. Any write clears the corresponding TPS CON.TEXP flag. Read returns the current Timer value. lsb=0 msb=31 access=read-write
      TPS_EXTIM description=TPS EXTIM addressOffset=58432
        ENTRY_LVAL description=CPUx Exception Entry Timer Load Value resetvalue={Application Reset:0x0} addressOffset=0 size=32 resetValue=0 resetMask=4294967295
          fields
            ENTRY_LVAL description=Exception Entry Timer Load value ENTRY LVAL. Value loaded into the exception entry timer on detection of an enabled exception. Bits 3 0 are constrained to be 0 lsb=4 msb=11 access=read-write
        ENTRY_CVAL description=CPUx Exception Entry Timer Current Value resetvalue={Application Reset:0x0} addressOffset=4 size=32 resetValue=0 resetMask=4294967295
          fields
            ENTRY_CVAL description=Exception Entry Timer Current Value ENTRY CVAL. Current value of the exception entry timer. lsb=0 msb=11 access=read-only
        EXIT_LVAL description=CPUx Exception Exit Timer Load Value resetvalue={Application Reset:0x0} addressOffset=8 size=32 resetValue=0 resetMask=4294967295
          fields
            EXIT_LVAL description=Exception Exit Timer Load value EXIT LVAL. Value loaded into the exception exit timer on detection of an enabled exception. Bits 3 0 are constrained to be 0 lsb=4 msb=23 access=read-write
        EXIT_CVAL description=CPUx Exception Exit Timer Current Value resetvalue={Application Reset:0x0} addressOffset=12 size=32 resetValue=0 resetMask=4294967295
          fields
            EXIT_CVAL description=Exception Exit Timer Current Value EXIT CVAL. Current value of the exception exit timer. lsb=0 msb=23 access=read-only
        CLASS_EN description=CPUx Exception Timer Class Enable Register resetvalue={Application Reset:0x0} addressOffset=16 size=32 resetValue=0 resetMask=4294967295
          fields
            EXTIM_CLASS_EN description=Exception Timer Class Enables EXTIM CLASS EN. Trap Class enables for exception timer. lsb=0 msb=7 access=read-write
        STAT description=CPUx Exception Timer Status Register resetvalue={Application Reset:0x0} addressOffset=20 size=32 resetValue=0 resetMask=4294967295
          fields
            EXIT_TIN description=Exception Exit Timer TIN EXIT TIN. Exception Exit Timer TIN of triggering trap. lsb=0 msb=7 access=read-write
            EXIT_CLASS description=Exception Exit Timer Class EXIT CLASS. Exception exit Timer Class of triggering trap. lsb=8 msb=10 access=read-write
            EXIT_AT description=Exception Exit Timer Alarm Triggered EXIT AT. Exception Exit Timer Alarm triggered sticky bit. Alarm triggered since last cleared. lsb=15 msb=15 access=read-only
            ENTRY_TIN description=Exception Entry Timer TIN ENTRY TIN. Exception Entry Timer TIN of triggering trap. lsb=16 msb=23 access=read-write
            ENTRY_CLASS description=Exception Entry Timer Class ENTRY CLASS. Exception Entry Timer Class of triggering trap. lsb=24 msb=26 access=read-write
            ENTRY_AT description=Exception Entry Timer Alarm Triggered ENTRY AT. Exception Entry Timer Alarm triggered sticky bit. Alarm triggered since last cleared. lsb=31 msb=31 access=read-only
        FCX description=CPUx Exception Timer FCX Register resetvalue={Application Reset:0x0} addressOffset=24 size=32 resetValue=0 resetMask=4294967295
          fields
            EXIT_FCX description=Exception Exit Timer FCX EXIT FCX. Exception Exit Timer FCX of triggering trap. lsb=0 msb=19 access=read-only
      FPU_TRAP description=FPU TRAP addressOffset=40960
        CON description=CPUx Trap Control Register resetvalue={Application Reset:0x0} addressOffset=0 size=32 resetValue=0 resetMask=4294967295
          fields
            TST description=Trap Status TST lsb=0 msb=0 access=read-only
              enumeratedValues
                Const_00 description=0 No instruction captured. The next enabled exception will cause the exceptional instruction to be captured. value=0
                Const_11 description=1 Instruction captured. No further enabled exceptions will be captured until TST is cleared. value=1
            TCL description=Trap Clear TCL. Read always reads as 0. lsb=1 msb=1 access=write-only
              enumeratedValues
                Const_00 description=0 No effect. value=0
                Const_11 description=1 Clears the trapped instruction TST will be negated . value=1
            RM description=Captured Rounding Mode RM. The rounding mode of the captured instruction. Only valid when TST is asserted. Note that this is the rounding mode supplied to the FPU for the exceptional instruction. UPDFL instructions may cause a trap and change the rounding mode. In this case the RM bits capture the input rounding mode lsb=8 msb=9 access=read-only
            FXE description=FX Trap Enable FXE. When set an instruction generating an FX exception will trigger a trap. lsb=18 msb=18 access=read-write
            FUE description=FU Trap Enable FUE. When set an instruction generating an FU exception will trigger a trap. lsb=19 msb=19 access=read-write
            FZE description=FZ Trap Enable FZE. When set an instruction generating an FZ exception will trigger a trap. lsb=20 msb=20 access=read-write
            FVE description=FV Trap Enable FVE. When set an instruction generating an FV exception will trigger a trap. lsb=21 msb=21 access=read-write
            FIE description=FI Trap Enable FIE. When set an instruction generating an FI exception will trigger a trap. lsb=22 msb=22 access=read-write
            FX description=Captured FX FX. Asserted if the captured instruction asserted FX. Only valid when TST is asserted. lsb=26 msb=26 access=read-only
            FU description=Captured FU FU. Asserted if the captured instruction asserted FU. Only valid when TST is asserted. lsb=27 msb=27 access=read-only
            FZ description=Captured FZ FZ. Asserted if the captured instruction asserted FZ. Only valid when TST is asserted lsb=28 msb=28 access=read-only
            FV description=Captured FV FV. Asserted if the captured instruction asserted FV. Only valid when TST is asserted lsb=29 msb=29 access=read-only
            FI description=Captured FI FI. Asserted if the captured instruction asserted FI. Only valid when TST is asserted lsb=30 msb=30 access=read-only
        PC description=CPUx Trapping Instruction Program Counter Register resetvalue={Application Reset:0x0} addressOffset=4 size=32 resetValue=0 resetMask=4294967295
          fields
            PC description=Captured Program Counter PC. The program counter virtual address of the captured instruction. Only valid when FPU TRAP CON.TST is asserted. lsb=0 msb=31 access=read-only
        OPC description=CPUx Trapping Instruction Opcode Register resetvalue={Application Reset:0x0} addressOffset=8 size=32 resetValue=0 resetMask=4294967295
          fields
            OPC description=Captured Opcode OPC. The secondary opcode of the captured instruction. When FPU TRAP OPC.FMT 0 only bits 3 0 are defined. OPC is valid only when FPU TRAP CON.TST is asserted. lsb=0 msb=7 access=read-only
            FMT description=Captured Instruction Format FMT. The format of the captured instruction s opcode. Only valid when FPU TRAP CON.TST is asserted. lsb=8 msb=8 access=read-only
              enumeratedValues
                Const_00 description=0 RRR value=0
                Const_11 description=1 RR value=1
            DREG description=Captured Destination Register DREG. The destination register of the captured instruction. ... Only valid when FPU TRAP CON.TST is asserted. lsb=16 msb=19 access=read-only
              enumeratedValues
                Const_00 description=0 Data general purpose register 0. value=0
                Const_1515 description=F Data general purpose register 15. value=15
        SRC1 description=CPUx Trapping Instruction Operand Register resetvalue={Application Reset:0x0} addressOffset=16 size=32 resetValue=0 resetMask=4294967295
          fields
            SRC1 description=Captured SRC1 Operand SRC1. The SRC1 operand of the captured instruction. Only valid when FPU TRAP CON.TST is asserted. lsb=0 msb=31 access=read-only
        SRC2 description=CPUx Trapping Instruction Operand Register resetvalue={Application Reset:0x0} addressOffset=20 size=32 resetValue=0 resetMask=4294967295
          fields
            SRC2 description=Captured SRC2 Operand SRC2. The SRC2 operand of the captured instruction. Only valid when FPU TRAP CON.TST is asserted. lsb=0 msb=31 access=read-only
        SRC3 description=CPUx Trapping Instruction Operand Register resetvalue={Application Reset:0x0} addressOffset=24 size=32 resetValue=0 resetMask=4294967295
          fields
            SRC3 description=Captured SRC3 Operand SRC3. The SRC3 operand of the captured instruction. Only valid when FPU TRAP CON.TST is asserted. lsb=0 msb=31 access=read-only
      TR[%s] dim=8 dimIncrement=8 description=Trigger addressOffset=61440
        TRiEVT description=CPUx Trigger Event 0 resetvalue={Debug Reset:0x0} addressOffset=0 size=32 resetValue=0 resetMask=4294967295
          fields
            EVTA description=Event Associated EVTA. Specifies the Debug Action associated with the Debug Event lsb=0 msb=2 access=read-write
              enumeratedValues
                Const_00 description=000 BOD 0 Disabled. BOD 1 Disabled. value=0
                Const_11 description=001 BOD 0 Pulse BRKOUT Signal. BOD 1 None. value=1
                Const_22 description=010 BOD 0 Halt and pulse BRKOUT Signal. BOD 1 Halt. value=2
                Const_33 description=011 BOD 0 Breakpoint trap and pulse BRKOUT Signal. BOD 1 Breakpoint trap. value=3
                Const_44 description=100 BOD 0 Breakpoint interrupt 0 and pulse BRKOUT Signal. BOD 1 Breakpoint interrupt 0. value=4
                Const_55 description=101 BOD 0 If implemented breakpoint interrupt 1 and pulse BRKOUT Signal. BOD 1 If implemented breakpoint interrupt 1. If not implemented None. value=5
                Const_66 description=110 BOD 0 If implemented breakpoint interrupt 2 and pulse BRKOUT Signal. BOD 1 If implemented breakpoint interrupt 2. If not implemented None. value=6
                Const_77 description=111 BOD 0 If implemented breakpoint interrupt 3 and pulse BRKOUT Signal. BOD 1 If implemented breakpoint interrupt 3. If not implemented None. value=7
            BBM description=Break Before Make BBM or Break After Make BAM Selection BBM. Code triggers BBM or BAM selection. Data access and data code combination access triggers can only create BAM Debug Events. When these triggers occur TRnEVT.BBM is ignored. lsb=3 msb=3 access=read-write
              enumeratedValues
                Const_00 description=0 Code only triggers Break After Make BAM . value=0
                Const_11 description=1 Code only triggers Break Before Make BBM . value=1
            BOD description=Breakout Disable BOD lsb=4 msb=4 access=read-write
              enumeratedValues
                Const_00 description=0 BRKOUT signal asserted according to the action specified in the EVTA field. value=0
                Const_11 description=1 BRKOUT signal not asserted. This takes priority over any assertion generated by the EVTA field. value=1
            SUSP description=CDC Suspend Out Signal State SUSP. Value to be assigned to the CDC suspend out signal when the Debug Event is raised. lsb=5 msb=5 access=read-write
            CNT description=Counter CNT. When this event occurs adjust the control of the performance counters in task mode as follows lsb=6 msb=7 access=read-write
              enumeratedValues
                Const_00 description=00 No change. value=0
                Const_11 description=01 Start the performance counters. value=1
                Const_22 description=10 Stop the performance counters. value=2
                Const_33 description=11 Toggle the performance counter control i.e. start it if it is currently stopped stop it if it is currently running . value=3
            TYP description=Input Selection TYP lsb=12 msb=12 access=read-write
              enumeratedValues
                Const_00 description=0 Address value=0
                Const_11 description=1 PC value=1
            RNG description=Compare Type RNG. Once an even numbered comparator has been set to range the EVTR settings of its associated upper neighbour will be ignored. lsb=13 msb=13 access=read-write
              enumeratedValues
                Const_11 description=1 Range value=1
                Const_00 description=0 Equality value=0
            ASI_EN description=Enable ASI Comparison ASI EN lsb=15 msb=15 access=read-write
              enumeratedValues
                Const_00 description=0 No ASI comparison performed. Debug Trigger is valid for all processes. value=0
                Const_11 description=1 Enable ASI comparison. Debug Events are only triggered when the current process ASI matches TRnEVT.ASI. value=1
            ASI description=Address Space Identifier ASI. The ASI of the Debug Trigger process. lsb=16 msb=20 access=read-write
            AST description=Address Store AST. Used in conjunction with TYP 0 lsb=27 msb=27 access=read-write
            ALD description=Address Load ALD. Used in conjunction with TYP 0 lsb=28 msb=28 access=read-write
        TRiADR description=CPUx Trigger Address 0 resetvalue={Debug Reset:0x0} addressOffset=4 size=32 resetValue=0 resetMask=4294967295
          fields
            ADDR description=Comparison Address ADDR. For PC comparison bit 0 is always zero. lsb=0 msb=31 access=read-write
      SMACON description=CPUx SIST Mode Access Control Register resetvalue={Application Reset:0x0} addressOffset=36876 size=32 resetValue=0 resetMask=4294967295
        fields
          IODT description=In Order Data Transactions IODT lsb=24 msb=24 access=read-write
            enumeratedValues
              Const_00 description=0 Normal operation Non dependent loads bypass stores. value=0
              Const_11 description=1 In order operation Loads always flush preceding stores processor store buffer disabled. value=1
      DIEAR description=CPUx Data Integrity Error Address Register resetvalue={Application Reset:0x0} addressOffset=36896 size=32 resetValue=0 resetMask=4294967295
        fields
          TA description=Transaction Address TA. Physical address being accessed by operation that encountered data integrity error. lsb=0 msb=31 access=read-only
      DIETR description=CPUx Data Integrity Error Trap Register resetvalue={Application Reset:0x0} addressOffset=36900 size=32 resetValue=0 resetMask=4294967295
        fields
          IED description=Integrity Error Detected IED lsb=0 msb=0 access=read-write
            enumeratedValues
              Const_00 description=0 Write Clear IED bit re enable DIETR and DIEAR update. Read No data integrity error condition occurred value=0
              Const_11 description=1 Write No Effect. Read Data integrity error condition detected. DIETR and DIEAR contents valid further DIETR and DIEAR updates disabled.. value=1
          IE_T description=Integrity Error Tag Memory IE T lsb=1 msb=1 access=read-only
          IE_C description=Integrity Error Cache Memory IE C lsb=2 msb=2 access=read-only
          IE_S description=Integrity Error Scratchpad Memory IE S lsb=3 msb=3 access=read-only
          IE_BI description=Integrity Error Bus Interface IE BI lsb=4 msb=4 access=read-only
          E_INFO description=Error Information E INFO. If IE BS 1 Bus Master Tag ID of requesting masterIf IE C 1 Cache way. lsb=5 msb=10 access=read-only
          IE_UNC description=Dual Bit Error Detected IE UNC lsb=11 msb=11 access=read-only
          IE_SP description=Safety Protection Error Detected IE SP lsb=12 msb=12 access=read-only
          IE_BS description=Bus Slave Access Indicator IE BS lsb=13 msb=13 access=read-only
          IE_DLMU description=Integrity Error DLMU IE DLMU lsb=14 msb=14 access=read-only
          IE_LPB description=Integrity Error Local Pflash Bank IE LPB lsb=15 msb=15 access=read-only
          IE_MTMV description=Memory Test Mode Violation detected IE MTMV lsb=16 msb=16 access=read-only
      PIEAR description=CPUx Program Integrity Error Address Register resetvalue={Application Reset:0x0} addressOffset=37392 size=32 resetValue=0 resetMask=4294967295
        fields
          TA description=Transaction Address TA. Physical address being accessed by operation that encountered program integrity error. lsb=0 msb=31 access=read-only
      PIETR description=CPUx Program Integrity Error Trap Register resetvalue={Application Reset:0x0} addressOffset=37396 size=32 resetValue=0 resetMask=4294967295
        fields
          IED description=Integrity Error Detected IED lsb=0 msb=0 access=read-write
            enumeratedValues
              Const_00 description=0 Write Clear IED bit re enable PIETR and PIEAR update. Read No data integrity error condition occurred value=0
              Const_11 description=1 Write No Effect. Read Data integrity error condition detected. PIETR and PIEAR contents valid further PIETR and PIEAR updates disabled.. value=1
          IE_T description=Integrity Error TAG Memory IE T lsb=1 msb=1 access=read-only
          IE_C description=Integrity Error Cache Memory IE C lsb=2 msb=2 access=read-only
          IE_S description=Integrity Error Scratchpad Memory IE S lsb=3 msb=3 access=read-only
          IE_BI description=Integrity Error Bus Interface IE BI lsb=4 msb=4 access=read-only
          E_INFO description=Error Information E INFO. If IE BS 1 Bus Master Tag ID of requesting masterIf IE C 1 Cache way. lsb=5 msb=10 access=read-only
          IE_UNC description=Integrity Error Uncorrectable Error Detected IE UNC lsb=11 msb=11 access=read-only
          IE_SP description=Safety Protection Error Detected IE SP lsb=12 msb=12 access=read-only
          IE_BS description=Bus Slave Access Indicator IE BS lsb=13 msb=13 access=read-only
          IE_ADDR description=Address Phase error detected at SRI slave interface IE ADDR lsb=14 msb=14 access=read-only
          IE_LPB description=Integrity Error Local Pflash bank IE LPB lsb=15 msb=15 access=read-only
          IE_MTMV description=Memory Test Mode Violation detected IE MTMV lsb=16 msb=16 access=read-only
      TASK_ASI description=CPUx Task Address Space Identifier Register resetvalue={Application Reset:0x1F} addressOffset=32772 size=32 resetValue=31 resetMask=4294967295
        fields
          ASI description=Address Space Identifier ASI. The ASI register contains the Address Space Identifier of the current process. lsb=0 msb=4 access=read-write
      PMA0 description=CPUx Data Access CacheabilityRegister resetvalue={Application Reset:0x300} addressOffset=33024 size=32 resetValue=768 resetMask=4294967295
        fields
          DAC description=Data Access Cacheability Segments FHto 0H DAC. Note segments F H E H D H and A H are constrained to be non cacheable lsb=0 msb=15 access=read-write
      PMA1 description=CPUx Code Access CacheabilityRegister resetvalue={Application Reset:0x300} addressOffset=33028 size=32 resetValue=768 resetMask=4294967295
        fields
          CAC description=Code Access Cacheability Segments FH 0H CAC. Note Segments F H E H C H A H are constrained to be non cacheable lsb=0 msb=15 access=read-write
      PMA2 description=CPUx Peripheral Space Identifier register resetvalue={Application Reset:0x0C000} addressOffset=33032 size=32 resetValue=49152 resetMask=4294967295
        fields
          PSI description=Peripheral Space Identifier Segments FH 0H PSI lsb=0 msb=15 access=read-only
      COMPAT description=CPUx Compatibility Control Register resetvalue={Application Reset:0x0FFFFFFFF} addressOffset=37888 size=32 resetValue=4294967295 resetMask=4294967295
        fields
          RM description=Rounding Mode Compatibility RM lsb=3 msb=3 access=read-write
            enumeratedValues
              Const_00 description=0 PSW.RM not restored by RET. value=0
              Const_11 description=1 PSW.RM restored by RET TC1.3 behavior . value=1
          SP description=SYSCON Safety Protection Mode Compatibility SP lsb=4 msb=4 access=read-write
            enumeratedValues
              Const_00 description=0 SYSCON 31 1 safety endinit protected. value=0
              Const_11 description=1 SYSCON 31 1 not safety endinit protected TC1.3 behavior . value=1
      PCXI description=CPUx Previous Context Information Register resetvalue={Application Reset:0x0} addressOffset=65024 size=32 resetValue=0 resetMask=4294967295
        fields
          PCXO description=Previous Context Pointer Offset Field PCXO. The PCXO and PCXS fields form the pointer PCX which points to the CSA of the previous context. lsb=0 msb=15 access=read-write
          PCXS description=Previous Context Pointer Segment Address PCXS. Contains the segment address portion of the PCX. This field is used in conjunction with the PCXO field. lsb=16 msb=19 access=read-write
          UL description=Upper or Lower Context Tag UL. Identifies the type of context saved. If the type does not match the type expected when a context restore operation is performed a trap is generated. lsb=20 msb=20 access=read-write
            enumeratedValues
              Const_00 description=0 Lower Context value=0
              Const_11 description=1 Upper Context value=1
          PIE description=Previous Interrupt Enable PIE. Indicates the state of the interrupt enable bit ICR.IE for the interrupted task. lsb=21 msb=21 access=read-write
          PCPN description=Previous CPU Priority Number PCPN. Contains the priority level number of the interrupted task. lsb=22 msb=29 access=read-write
      PSW description=CPUx Program Status Word resetvalue={Application Reset:0x0B80} addressOffset=65028 size=32 resetValue=2944 resetMask=4294967295
        fields
          CDC description=Call Depth Counter CDC. Consists of two variable width subfields. The first subfield consists of a string of zero or more initial 1 bits terminated by the first 0 bit. The remaining bits form the second subfield CDC.COUNT which constitutes the Call Depth Count value. The count value is incremented on each Call and is decremented on a Return. 0cccccc B 6 bit counter trap on overflow. 10ccccc B 5 bit counter trap on overflow. 110cccc B 4 bit counter trap on overflow. 1110ccc B 3 bit counter trap on overflow. 11110cc B 2 bit counter trap on overflow. 111110c B 1 bit counter trap on overflow. 1111110 B Trap every call Call Trace mode . 1111111 B Disable Call Depth Counting. When the call depth count CDC.COUNT overflows a trap CDO is generated. Setting the CDC to 1111110 B allows no bits for the counter and causes every call to be trapped. This is used for Call Depth Tracing. Setting the CDC to 1111111 B disables Call Depth Counting. lsb=0 msb=6 access=read-write
          CDE description=Call Depth Count Enable CDE. Enables call depth counting provided that the PSW.CDC mask field is not all set to 1. If PSW.CDC 1111111 B call depth counting is disabled regardless of the setting on the PSW.CDE bit. lsb=7 msb=7 access=read-write
            enumeratedValues
              Const_00 description=0 Call depth counting is temporarily disabled. It is automatically re enabled after execution of the next Call instruction. value=0
              Const_11 description=1 Call depth counting is enabled. value=1
          IS description=Interrupt Stack Control IS. Determines if the current execution thread is using the shared global interrupt stack or a user stack. lsb=9 msb=9 access=read-write
            enumeratedValues
              Const_00 description=0 User Stack. If an interrupt is taken when the IS bit is 0 then the stack pointer register is loaded from the ISP register before execution starts at the first instruction of the Interrupt Service Routine ISR . value=0
              Const_11 description=1 Shared Global Stack. If an interrupt is taken when the PSW.IS bit is 1 then the current value of the stack pointer is used by the Interrupt Service Routine ISR . value=1
          IO description=Access Privilege Level Control I O Privilege IO. Determines the access level to special function registers and peripheral devices. lsb=10 msb=11 access=read-write
            enumeratedValues
              Const_00 description=00 User 0 Mode No peripheral access. Access to memory regions with the peripheral space attribute are prohibited and results in a PSE or MPP trap. This access level is given to tasks that need not directly access peripheral devices. Tasks at this level do not have permission to enable or disable interrupts. value=0
              Const_11 description=01 User 1 Mode Regular peripheral access. Enables access to common peripheral devices that are not specially protected including read write access to serial I O ports read access to timers and access to most I O status registers. Tasks at this level may disable interrupts. value=1
              Const_22 description=10 Supervisor Mode Enables access to all peripheral devices. It enables read write access to core registers and protected peripheral devices. Tasks at this level may disable interrupts. value=2
          S description=Safe Task Identifier S lsb=14 msb=14 access=read-write
          USB description=User Status Bits USB. The eight most significant bits of the PSW are designated as User Status Bits. These bits may be set or cleared as side effects of instruction execution. Refer to the TriCore Architecture manual for details. lsb=24 msb=31 access=read-write
      PC description=CPUx Program Counter resetvalue={Application Reset:0x0} addressOffset=65032 size=32 resetValue=0 resetMask=0
        fields
          PC description=Program Counter PC lsb=1 msb=31 access=read-write
      SYSCON description=CPUx System Configuration Register resetvalue={Application Reset:0x0,Application Reset:0x0} addressOffset=65044 size=32 resetValue=0 resetMask=0
        fields
          FCDSF description=Free Context List Depleted Sticky Flag FCDSF. This sticky bit indicates that a FCD Free Context List Depleted trap occurred since the bit was last cleared by software. lsb=0 msb=0 access=read-write
            enumeratedValues
              Const_00 description=0 No FCD trap occurred since the last clear. value=0
              Const_11 description=1 An FCD trap occurred since the last clear. value=1
          PROTEN description=Memory Protection Enable PROTEN. Enables the memory protection system. Memory protection is controlled through the memory protection register sets. Note Initialize the protection register sets prior to setting PROTEN to one. lsb=1 msb=1 access=read-write
            enumeratedValues
              Const_00 description=0 Memory Protection is disabled. value=0
              Const_11 description=1 Memory Protection is enabled. value=1
          TPROTEN description=Temporal Protection Enable TPROTEN. Enable the Temporal Protection system. lsb=2 msb=2 access=read-write
            enumeratedValues
              Const_00 description=0 Temporal Protection is disabled. value=0
              Const_11 description=1 Temporal Protection is enabled. value=1
          IS description=Initial State Interrupt IS. of PSW.S bit in interrupt handle lsb=3 msb=3 access=read-write
          TS description=Initial State Trap TS. of PSW.S bit in trap handle lsb=4 msb=4 access=read-write
          ESDIS description=Emulator Space Disable. Disable the Emulator Space system lsb=8 msb=8 access=read-write
          U1_IED description=User 1 Instruction execution disable U1 IED. Disable the execution of User 1 mode instructions in User 1 IO mode. Disables User 1 ability to enable and disable interrupts. lsb=16 msb=16 access=read-write
          U1_IOS description=User 1 Peripheral access as supervisor U1 IOS. Allow User 1 mode tasks to access peripherals as if in Supervisor mode. Enables User 1 access to all peripheral registers. lsb=17 msb=17 access=read-write
          BHALT description=Boot Halt BHALT lsb=24 msb=24 access=read-write
            enumeratedValues
              Const_00 description=0 Core is not in boot halt. value=0
              Const_11 description=1 Core is in boot halt write to 0 will exit value=1
      CPU_ID description=CPUx Identification Register TC1.6.2P resetvalue={Application Reset:0x0C0C021} addressOffset=65048 size=32 resetValue=12632097 resetMask=4294967295
        fields
          MOD_REV description=Revision Number MOD REV lsb=0 msb=7 access=read-only
            enumeratedValues
              Const_3232 description=20 Reset value value=32
          MOD_32B description=32 Bit Module Enable MOD 32B lsb=8 msb=15 access=read-only
            enumeratedValues
              Const_192192 description=C0 A value of C0 H in this field indicates a 32 bit module with a 32 bit module ID register. value=192
          MOD description=Module Identification Number MOD lsb=16 msb=31 access=read-only
            enumeratedValues
              Const_192192 description=00C0 For module identification. value=192
      CORE_ID description=CPUx Core Identification Register resetvalue={Application Reset:0x0} addressOffset=65052 size=32 resetValue=0 resetMask=4294967288
        fields
          CORE_ID description=Core Identification Number CORE ID. The identification number of the core. lsb=0 msb=2 access=read-only
      BIV description=CPUx Base Interrupt Vector Table Pointer resetvalue={Application Reset:0x0} addressOffset=65056 size=32 resetValue=0 resetMask=4294967295
        fields
          VSS description=Vector Spacing Select VSS. 0 32 byte vector spacing. 1 8 Byte vector spacing. lsb=0 msb=0 access=read-write
          BIV description=Base Address of Interrupt Vector Table BIV. The address in the BIV register must be aligned to an even byte address halfword address . Because of the simple ORing of the left shifted priority number and the contents of the BIV register the alignment of the base address of the vector table must be to a power of two boundary dependent on the number of interrupt entries used. For the full range of 256 interrupt entries an alignment to an 8 KByte boundary is required. If fewer sources are used the alignment requirements are correspondingly relaxed. lsb=1 msb=31 access=read-write
      BTV description=CPUx Base Trap Vector Table Pointer resetvalue={Application Reset:0x0A0000100} addressOffset=65060 size=32 resetValue=2684354816 resetMask=4294967295
        fields
          BTV description=Base Address of Trap Vector Table BTV. The address in the BTV register must be aligned to an even byte address halfword address . Also due to the simple ORing of the left shifted trap identification number and the contents of the BTV register the alignment of the base address of the vector table must be to a power of two boundary. There are eight different trap classes resulting in Trap Classes from 0 to 7. The contents of BTV should therefore be set to at least a 256 byte boundary 8 Trap Classes 8 word spacing . lsb=1 msb=31 access=read-write
      ISP description=CPUx Interrupt Stack Pointer resetvalue={Application Reset:0x100} addressOffset=65064 size=32 resetValue=256 resetMask=4294967295
        fields
          ISP description=Interrupt Stack Pointer ISP lsb=0 msb=31 access=read-write
      ICR description=CPUx Interrupt Control Register resetvalue={Application Reset:0x0} addressOffset=65068 size=32 resetValue=0 resetMask=4294967295
        fields
          CCPN description=Current CPU Priority Number CCPN. The Current CPU Priority Number CCPN bit field indicates the current priority level of the CPU. It is automatically updated by hardware on entry or exit of Interrupt Service Routines ISRs and through the execution of a BISR instruction. CCPN can also be updated through an MTCR instruction. lsb=0 msb=7 access=read-write
          IE description=Global Interrupt Enable Bit IE. The interrupt enable bit globally enables the CPU service request system. Whether a service request is delivered to the CPU depends on the individual Service Request Enable Bits SRE in the SRNs and the current state of the CPU. ICR.IE is automatically updated by hardware on entry and exit of an Interrupt Service Routine ISR . ICR.IE is cleared to 0 when an interrupt is taken and is restored to the previous value when the ISR executes an RFE instruction to terminate itself. ICR.IE can also be updated through the execution of the ENABLE DISABLE MTCR and BISR instructions. lsb=15 msb=15 access=read-write
            enumeratedValues
              Const_00 description=0 Interrupt system is globally disabled value=0
              Const_11 description=1 Interrupt system is globally enabled value=1
          PIPN description=Pending Interrupt Priority Number PIPN. A read only bit field that is updated by the ICU at the end of each interrupt arbitration process. It indicates the priority number of the pending service request. ICR.PIPN is set to 0 when no request is pending and at the beginning of each new arbitration process. ... lsb=16 msb=23 access=read-only
            enumeratedValues
              Const_00 description=00 No valid pending request. value=0
              Const_11 description=01 Request pending lowest priority. value=1
              Const_255255 description=FF Request pending highest priority. value=255
      FCX description=CPUx Free CSA List Head Pointer resetvalue={Application Reset:0x0} addressOffset=65080 size=32 resetValue=0 resetMask=4294967295
        fields
          FCXO description=FCX Offset Address Field FCXO. The FCXO and FCXS fields together form the FCX pointer which points to the next available CSA. lsb=0 msb=15 access=read-write
          FCXS description=FCX Segment Address Field FCXS. Used in conjunction with the FCXO field. lsb=16 msb=19 access=read-write
      LCX description=CPUx Free CSA List Limit Pointer resetvalue={Application Reset:0x0} addressOffset=65084 size=32 resetValue=0 resetMask=4294967295
        fields
          LCXO description=LCX Offset Field LCXO. The LCXO and LCXS fields form the pointer LCX which points to the last available CSA. lsb=0 msb=15 access=read-write
          LCXS description=LCX Segment Address LCXS. This field is used in conjunction with the LCXO field. lsb=16 msb=19 access=read-write
      CUS_ID description=CPUx Customer ID register resetvalue={Application Reset:0x0} addressOffset=65104 size=32 resetValue=0 resetMask=4294967288
        fields
          CID description=Customer ID CID. See CROSSREFERENCE for the relation between CUS ID and CORE ID for each derivative lsb=0 msb=2 access=read-only
      Dy[%s] dim=16 dimIncrement=4 description=CPUx Data General Purpose Register 0 resetvalue={Application Reset:0x0} addressOffset=65280 size=32 resetValue=0 resetMask=0
        fields
          DATA description=Data Register DATA. General purpose registers lsb=0 msb=31 access=read-write
      Ay[%s] dim=16 dimIncrement=4 description=CPUx Address General Purpose Register 0 resetvalue={Application Reset:0x0} addressOffset=65408 size=32 resetValue=0 resetMask=0
        fields
          ADDR description=Address Register ADDR. General purpose registers lsb=0 msb=31 access=read-write
      CPXE_0 description=CPUx Code Protection Execute Enable Register Set 3 resetvalue={Application Reset:0x0} addressOffset=57344 size=32 resetValue=0 resetMask=4294967295
        fields
          XE_n description=Execute Enable Range select XE n lsb=0 msb=9 access=read-write
            enumeratedValues
              Const_00 description=0 Code Protection Range n not enabled for execution value=0
              Const_11 description=1 Code Protection Range n enabled for execution value=1
      CPXE_1 description=CPUx Code Protection Execute Enable Register Set 3 resetvalue={Application Reset:0x0} addressOffset=57348 size=32 resetValue=0 resetMask=4294967295
        fields
          XE_n description=Execute Enable Range select XE n lsb=0 msb=9 access=read-write
            enumeratedValues
              Const_00 description=0 Code Protection Range n not enabled for execution value=0
              Const_11 description=1 Code Protection Range n enabled for execution value=1
      CPXE_2 description=CPUx Code Protection Execute Enable Register Set 3 resetvalue={Application Reset:0x0} addressOffset=57352 size=32 resetValue=0 resetMask=4294967295
        fields
          XE_n description=Execute Enable Range select XE n lsb=0 msb=9 access=read-write
            enumeratedValues
              Const_00 description=0 Code Protection Range n not enabled for execution value=0
              Const_11 description=1 Code Protection Range n enabled for execution value=1

## Notices in the file
Copyright (C) 2012-2014 ARM Limited. All rights reserved.
Purpose: System Viewer Description (SVD) Example (Schema Version 1.1)
This is a description of a none-existent and incomplete device
for demonstration purposes only.
Redistribution and use in source and binary forms, with or without
modification, are permitted provided that the following conditions are met:
- Redistributions of source code must retain the above copyright
notice, this list of conditions and the following disclaimer.
- Redistributions in binary form must reproduce the above copyright
notice, this list of conditions and the following disclaimer in the
documentation and/or other materials provided with the distribution.
- Neither the name of ARM nor the names of its contributors may be used
to endorse or promote products derived from this software without
specific prior written permission.
THIS SOFTWARE IS PROVIDED BY THE COPYRIGHT HOLDERS AND CONTRIBUTORS "AS IS"
AND ANY EXPRESS OR IMPLIED WARRANTIES, INCLUDING, BUT NOT LIMITED TO, THE
IMPLIED WARRANTIES OF MERCHANTABILITY AND FITNESS FOR A PARTICULAR PURPOSE
ARE DISCLAIMED. IN NO EVENT SHALL COPYRIGHT HOLDERS AND CONTRIBUTORS BE
LIABLE FOR ANY DIRECT, INDIRECT, INCIDENTAL, SPECIAL, EXEMPLARY, OR
CONSEQUENTIAL DAMAGES (INCLUDING, BUT NOT LIMITED TO, PROCUREMENT OF
SUBSTITUTE GOODS OR SERVICES; LOSS OF USE, DATA, OR PROFITS; OR BUSINESS
INTERRUPTION) HOWEVER CAUSED AND ON ANY THEORY OF LIABILITY, WHETHER IN
CONTRACT, STRICT LIABILITY, OR TORT (INCLUDING NEGLIGENCE OR OTHERWISE)
ARISING IN ANY WAY OUT OF THE USE OF THIS SOFTWARE, EVEN IF ADVISED OF THE
POSSIBILITY OF SUCH DAMAGE.
