# ARM_Example register map
Vendor: Infineon; Series: ARMCM3; File version: 1.2
CPU: CM3 r1p0, little endian, MPU, FPU, 3 interrupt priority bits

## Further device data (continued)
      CPXE_3 description=CPUx Code Protection Execute Enable Register Set 3 resetvalue={Application Reset:0x0} addressOffset=57356 size=32 resetValue=0 resetMask=4294967295
        fields
          XE_n description=Execute Enable Range select XE n lsb=0 msb=9 access=read-write
            enumeratedValues
              Const_00 description=0 Code Protection Range n not enabled for execution value=0
              Const_11 description=1 Code Protection Range n enabled for execution value=1
      DPRE_0 description=CPUx Data Protection Read Enable Register Set 3 resetvalue={Application Reset:0x0} addressOffset=57360 size=32 resetValue=0 resetMask=4294967295
        fields
          RE_n description=Read Enable Range Select RE n lsb=0 msb=17 access=read-write
            enumeratedValues
              Const_00 description=0 Data Protection Range n not enabled for data read value=0
              Const_11 description=1 Data Protection Range n enabled for data read value=1
      DPRE_1 description=CPUx Data Protection Read Enable Register Set 3 resetvalue={Application Reset:0x0} addressOffset=57364 size=32 resetValue=0 resetMask=4294967295
        fields
          RE_n description=Read Enable Range Select RE n lsb=0 msb=17 access=read-write
            enumeratedValues
              Const_00 description=0 Data Protection Range n not enabled for data read value=0
              Const_11 description=1 Data Protection Range n enabled for data read value=1
      DPRE_2 description=CPUx Data Protection Read Enable Register Set 3 resetvalue={Application Reset:0x0} addressOffset=57368 size=32 resetValue=0 resetMask=4294967295
        fields
          RE_n description=Read Enable Range Select RE n lsb=0 msb=17 access=read-write
            enumeratedValues
              Const_00 description=0 Data Protection Range n not enabled for data read value=0
              Const_11 description=1 Data Protection Range n enabled for data read value=1
      DPRE_3 description=CPUx Data Protection Read Enable Register Set 3 resetvalue={Application Reset:0x0} addressOffset=57372 size=32 resetValue=0 resetMask=4294967295
        fields
          RE_n description=Read Enable Range Select RE n lsb=0 msb=17 access=read-write
            enumeratedValues
              Const_00 description=0 Data Protection Range n not enabled for data read value=0
              Const_11 description=1 Data Protection Range n enabled for data read value=1
      DPWE_0 description=CPUx Data Protection Write Enable Register Set 3 resetvalue={Application Reset:0x0} addressOffset=57376 size=32 resetValue=0 resetMask=4294967295
        fields
          WE_n description=Write Enable Range Select WE n lsb=0 msb=17 access=read-write
            enumeratedValues
              Const_00 description=0 Data Protection Range n not enabled for data write value=0
              Const_11 description=1 Data Protection Range n enabled for data write value=1
      DPWE_1 description=CPUx Data Protection Write Enable Register Set 3 resetvalue={Application Reset:0x0} addressOffset=57380 size=32 resetValue=0 resetMask=4294967295
        fields
          WE_n description=Write Enable Range Select WE n lsb=0 msb=17 access=read-write
            enumeratedValues
              Const_00 description=0 Data Protection Range n not enabled for data write value=0
              Const_11 description=1 Data Protection Range n enabled for data write value=1
      DPWE_2 description=CPUx Data Protection Write Enable Register Set 3 resetvalue={Application Reset:0x0} addressOffset=57384 size=32 resetValue=0 resetMask=4294967295
        fields
          WE_n description=Write Enable Range Select WE n lsb=0 msb=17 access=read-write
            enumeratedValues
              Const_00 description=0 Data Protection Range n not enabled for data write value=0
              Const_11 description=1 Data Protection Range n enabled for data write value=1
      DPWE_3 description=CPUx Data Protection Write Enable Register Set 3 resetvalue={Application Reset:0x0} addressOffset=57388 size=32 resetValue=0 resetMask=4294967295
        fields
          WE_n description=Write Enable Range Select WE n lsb=0 msb=17 access=read-write
            enumeratedValues
              Const_00 description=0 Data Protection Range n not enabled for data write value=0
              Const_11 description=1 Data Protection Range n enabled for data write value=1
      CPXE_4 description=CPUx Code Protection Execute Enable Register Set 5 resetvalue={Application Reset:0x0} addressOffset=57408 size=32 resetValue=0 resetMask=4294967295
        fields
          XE_n description=Execute Enable Range select XE n lsb=0 msb=9 access=read-write
            enumeratedValues
              Const_00 description=0 Code Protection Range n not enabled for execution value=0
              Const_11 description=1 Code Protection Range n enabled for execution value=1
      CPXE_5 description=CPUx Code Protection Execute Enable Register Set 5 resetvalue={Application Reset:0x0} addressOffset=57412 size=32 resetValue=0 resetMask=4294967295
        fields
          XE_n description=Execute Enable Range select XE n lsb=0 msb=9 access=read-write
            enumeratedValues
              Const_00 description=0 Code Protection Range n not enabled for execution value=0
              Const_11 description=1 Code Protection Range n enabled for execution value=1
      DPRE_4 description=CPUx Data Protection Read Enable Register Set 5 resetvalue={Application Reset:0x0} addressOffset=57424 size=32 resetValue=0 resetMask=4294967295
        fields
          RE_n description=Read Enable Range Select RE n lsb=0 msb=17 access=read-write
            enumeratedValues
              Const_00 description=0 Data Protection Range n not enabled for data read value=0
              Const_11 description=1 Data Protection Range n enabled for data read value=1
      DPRE_5 description=CPUx Data Protection Read Enable Register Set 5 resetvalue={Application Reset:0x0} addressOffset=57428 size=32 resetValue=0 resetMask=4294967295
        fields
          RE_n description=Read Enable Range Select RE n lsb=0 msb=17 access=read-write
            enumeratedValues
              Const_00 description=0 Data Protection Range n not enabled for data read value=0
              Const_11 description=1 Data Protection Range n enabled for data read value=1
      DPWE_4 description=CPUx Data Protection Write Enable Register Set 5 resetvalue={Application Reset:0x0} addressOffset=57440 size=32 resetValue=0 resetMask=4294967295
        fields
          WE_n description=Write Enable Range Select WE n lsb=0 msb=17 access=read-write
            enumeratedValues
              Const_00 description=0 Data Protection Range n not enabled for data write value=0
              Const_11 description=1 Data Protection Range n enabled for data write value=1
      DPWE_5 description=CPUx Data Protection Write Enable Register Set 5 resetvalue={Application Reset:0x0} addressOffset=57444 size=32 resetValue=0 resetMask=4294967295
        fields
          WE_n description=Write Enable Range Select WE n lsb=0 msb=17 access=read-write
            enumeratedValues
              Const_00 description=0 Data Protection Range n not enabled for data write value=0
              Const_11 description=1 Data Protection Range n enabled for data write value=1
      CCTRL description=CPUx Counter Control resetvalue={Debug Reset:0x0} addressOffset=64512 size=32 resetValue=0 resetMask=4294967295
        fields
          CM description=Counter Mode CM lsb=0 msb=0 access=read-write
            enumeratedValues
              Const_00 description=0 Normal Mode. value=0
              Const_11 description=1 Task Mode. value=1
          CE description=Count Enable CE lsb=1 msb=1 access=read-write
            enumeratedValues
              Const_00 description=0 Disable the counters CCNT ICNT M1CNT M2CNT M3CNT. value=0
              Const_11 description=1 Enable the counters CCNT ICNT M1CNT M2CNT M3CNT. value=1
          M1 description=M1CNT Configuration M1 lsb=2 msb=4 access=read-write
          M2 description=M2CNT Configuration M2 lsb=5 msb=7 access=read-write
          M3 description=M3CNT Configuration M3 lsb=8 msb=10 access=read-write
      CCNT description=CPUx CPU Clock Cycle Count resetvalue={Debug Reset:0x0} addressOffset=64516 size=32 resetValue=0 resetMask=4294967295
        fields
          CountValue description=Count Value CountValue. Current Count of the CPU Clock Cycles. lsb=0 msb=30 access=read-write
          SOvf description=Sticky Overflow Bit SOvf. This bit is set by hardware when count value 30 0 31 h7FFF FFFF. It can only be cleared by software. lsb=31 msb=31 access=read-write
      ICNT description=CPUx Instruction Count resetvalue={Debug Reset:0x0} addressOffset=64520 size=32 resetValue=0 resetMask=4294967295
        fields
          CountValue description=Count Value CountValue. Count of the Instructions Executed. lsb=0 msb=30 access=read-write
          SOvf description=Sticky Overflow Bit SOvf. This bit is set by hardware when count value 30 0 31 h7FFF FFFF. It can only be cleared by software. lsb=31 msb=31 access=read-write
      M1CNT description=CPUx Multi Count Register 1 resetvalue={Debug Reset:0x0} addressOffset=64524 size=32 resetValue=0 resetMask=4294967295
        fields
          CountValue description=Count Value CountValue. Count of the Selected Event. lsb=0 msb=30 access=read-write
          SOvf description=Sticky Overflow Bit SOvf. This bit is set by hardware when count value 30 0 31 h7FFF FFFF. It can only be cleared by software. lsb=31 msb=31 access=read-write
      M2CNT description=CPUx Multi Count Register 2 resetvalue={Debug Reset:0x0} addressOffset=64528 size=32 resetValue=0 resetMask=4294967295
        fields
          CountValue description=Count Value CountValue. Count of the Selected Event. lsb=0 msb=30 access=read-write
          SOvf description=Sticky Overflow Bit SOvf. This bit is set by hardware when count value 30 0 31 h7FFF FFFF. It can only be cleared by software. lsb=31 msb=31 access=read-write
      M3CNT description=CPUx Multi Count Register 3 resetvalue={Debug Reset:0x0} addressOffset=64532 size=32 resetValue=0 resetMask=4294967295
        fields
          CountValue description=Count Value CountValue. Count of the Selected Event. lsb=0 msb=30 access=read-write
          SOvf description=Sticky Overflow Bit SOvf. This bit is set by hardware when count value 30 0 31 h7FFF FFFF. It can only be cleared by software. lsb=31 msb=31 access=read-write
      DBGSR description=CPUx Debug Status Register resetvalue={Debug Reset:0x0} addressOffset=64768 size=32 resetValue=0 resetMask=4294967295
        fields
          DE description=Debug Enable DE. Determines whether the CDC is enabled or not. lsb=0 msb=0 access=read-only
            enumeratedValues
              Const_00 description=0 The CDC is disabled. value=0
              Const_11 description=1 The CDC is enabled. value=1
          HALT description=CPU Halt Request Status Field HALT. HALT can be set or cleared by software. HALT 0 is the actual Halt bit. HALT 1 is a mask bit to specify whether or not HALT 0 is to be updated on a software write. HALT 1 is always read as 0. HALT 1 must be set to 1 in order to update HALT 0 by software R read W write . lsb=1 msb=2 access=read-write
            enumeratedValues
              Const_00 description=00 R CPU running. W HALT 0 unchanged. value=0
              Const_11 description=01 R CPU halted. W HALT 0 unchanged. value=1
              Const_22 description=10 R Not Applicable. W reset HALT 0 . value=2
              Const_33 description=11 R Not Applicable. W If DBGSR.DE 1 The CDC is enabled set HALT 0 . If DBGSR.DE 0 The CDC is not enabled HALT 0 is left unchanged. value=3
          SIH description=Suspend in Halt SIH. State of the Suspend In signal. lsb=3 msb=3 access=read-only
            enumeratedValues
              Const_00 description=0 The Suspend In signal is negated. The CPU is not in Halt Mode except when the Halt mechanism is set following a Debug Event or a write to DBGSR.HALT . value=0
              Const_11 description=1 The Suspend In signal is asserted. The CPU is in Halt Mode. value=1
          SUSP description=Current State of the Core Suspend Out Signal SUSP lsb=4 msb=4 access=read-write
            enumeratedValues
              Const_00 description=0 Core suspend out inactive. value=0
              Const_11 description=1 Core suspend out active. value=1
          PREVSUSP description=Previous State of Core Suspend Out Signal PREVSUSP. Updated when a Debug Event causes a hardware update of DBGSR.SUSP. This field is not updated for writes to DBGSR.SUSP. lsb=6 msb=6 access=read-only
            enumeratedValues
              Const_00 description=0 Previous core suspend out inactive. value=0
              Const_11 description=1 Previous core suspend out active. value=1
          PEVT description=Posted Event PEVT lsb=7 msb=7 access=read-write
            enumeratedValues
              Const_00 description=0 No posted event. value=0
              Const_11 description=1 Posted event. value=1
      EXEVT description=CPUx External Event Register resetvalue={Debug Reset:0x0} addressOffset=64776 size=32 resetValue=0 resetMask=4294967295
        fields
          EVTA description=Event Associated EVTA. Specifies the Debug Action associated with the Debug Event lsb=0 msb=2 access=read-write
            enumeratedValues
              Const_00 description=000 BOD 0 Disabled. BOD 1 Disabled. value=0
              Const_11 description=001 BOD 0 Pulse BRKOUT Signal. BOD 1 None. value=1
              Const_22 description=010 BOD 0 Halt and pulse BRKOUT Signal. BOD 1 Halt. value=2
              Const_33 description=011 BOD 0 Breakpoint trap and pulse. BRKOUT Signal. BOD 1 Breakpoint trap. value=3
              Const_44 description=100 BOD 0 Breakpoint interrupt 0 and pulse BRKOUT Signal. BOD 1 Breakpoint interrupt 0. value=4
              Const_55 description=101 BOD 0 If implemented breakpoint interrupt 1 and pulse BRKOUT Signal. BOD 1 If implemented breakpoint interrupt 1. If not implemented None. value=5
              Const_66 description=110 BOD 0 If implemented breakpoint interrupt 2 and pulse BRKOUT Signal. BOD 1 If implemented breakpoint interrupt 2. If not implemented None. value=6
              Const_77 description=111 BOD 0 If implemented breakpoint interrupt 3 and pulse BRKOUT Signal. BOD 1 If implemented breakpoint interrupt 3. If not implemented None. value=7
          BBM description=Break Before Make BBM or Break After Make BAM Selection BBM lsb=3 msb=3 access=read-write
            enumeratedValues
              Const_00 description=0 Break after make BAM . value=0
              Const_11 description=1 Break before make BBM . value=1
          BOD description=Breakout Disable BOD lsb=4 msb=4 access=read-write
            enumeratedValues
              Const_00 description=0 BRKOUT signal asserted according to the Debug Action specified in the EVTA field. value=0
              Const_11 description=1 BRKOUT signal not asserted. This takes priority over any assertion generated by the EVTA field. value=1
          SUSP description=CDC Suspend Out Signal State SUSP. Value to be assigned to the CDC suspend out signal when the Debug Event is raised. lsb=5 msb=5 access=read-write
          CNT description=Counter CNT. When this event occurs adjust the control of the performance counters in task mode as follows lsb=6 msb=7 access=read-write
            enumeratedValues
              Const_00 description=00 No change. value=0
              Const_11 description=01 Start the performance counters. value=1
              Const_22 description=10 Stop the performance counters. value=2
              Const_33 description=11 Toggle the performance counter control i.e. start it if it is currently stopped stop it if it is currently running . value=3
      CREVT description=CPUx Core Register Access Event resetvalue={Debug Reset:0x0} addressOffset=64780 size=32 resetValue=0 resetMask=4294967295
        fields
          EVTA description=Event Associated EVTA. Debug Action associated with the Debug Event lsb=0 msb=2 access=read-write
            enumeratedValues
              Const_00 description=000 BOD 0 Disabled. BOD 1 Disabled. value=0
              Const_11 description=001 BOD 0 Pulse BRKOUT Signal. BOD 1 None. value=1
              Const_22 description=010 BOD 0 Halt and pulse BRKOUT Signal. BOD 1 Halt. value=2
              Const_33 description=011 BOD 0 Breakpoint trap and pulse BRKOUT Signal. BOD 1 Breakpoint trap. value=3
              Const_44 description=100 BOD 0 Breakpoint interrupt 0 and pulse BRKOUT Signal. BOD 1 Breakpoint interrupt 0. value=4
              Const_55 description=101 BOD 0 If implemented breakpoint interrupt 1 and pulse BRKOUT Signal. BOD 1 If implemented breakpoint interrupt 1. If not implemented None. value=5
              Const_66 description=110 BOD 0 If implemented breakpoint interrupt 2 and pulse BRKOUT Signal. BOD 1 If implemented breakpoint interrupt 2. If not implemented None. value=6
              Const_77 description=111 BOD 0 If implemented breakpoint interrupt 3 and pulse BRKOUT Signal. BOD 1 If implemented breakpoint interrupt 3. If not implemented None. value=7
          BBM description=Break Before Make BBM or Break After Make BAM Selection BBM lsb=3 msb=3 access=read-write
            enumeratedValues
              Const_00 description=0 Break after make BAM . value=0
              Const_11 description=1 Break before make BBM . value=1
          BOD description=Breakout Disable BOD lsb=4 msb=4 access=read-write
            enumeratedValues
              Const_00 description=0 BRKOUT signal asserted according to the action specified in the EVTA field. value=0
              Const_11 description=1 BRKOUT signal not asserted. This takes priority over any assertion generated by the EVTA field. value=1
          SUSP description=CDC Suspend Out Signal State SUSP. Value to be assigned to the CDC suspend out signal when the Debug Event is raised. lsb=5 msb=5 access=read-write
          CNT description=Counter CNT. When this event occurs adjust the control of the performance counters in task mode as follows lsb=6 msb=7 access=read-write
            enumeratedValues
              Const_00 description=00 No change. value=0
              Const_11 description=01 Start the performance counters. value=1
              Const_22 description=10 Stop the performance counters. value=2
              Const_33 description=11 Toggle the performance counter control i.e. start it if it is currently stopped stop it if it is currently running . value=3
      SWEVT description=CPUx Software Debug Event resetvalue={Debug Reset:0x0} addressOffset=64784 size=32 resetValue=0 resetMask=4294967295
        fields
          EVTA description=Event Associated EVTA. Debug Action associated with the Debug Event lsb=0 msb=2 access=read-write
            enumeratedValues
              Const_00 description=000 BOD 0 Disabled. BOD 1 Disabled. value=0
              Const_11 description=001 BOD 0 Pulse BRKOUT Signal. BOD 1 None. value=1
              Const_22 description=010 BOD 0 Halt and pulse BRKOUT Signal. BOD 1 Halt. value=2
              Const_33 description=011 BOD 0 Breakpoint trap and pulse BRKOUT Signal. BOD 1 Breakpoint trap. value=3
              Const_44 description=100 BOD 0 Breakpoint interrupt 0 and pulse BRKOUT Signal. BOD 1 Breakpoint interrupt 0. value=4
              Const_55 description=101 BOD 0 If implemented breakpoint interrupt 1 and pulse BRKOUT Signal. BOD 1 If implemented breakpoint interrupt 1. If not implemented None. value=5
              Const_66 description=110 BOD 0 If implemented breakpoint interrupt 2 and pulse BRKOUT Signal. BOD 1 If implemented breakpoint interrupt 2. If not implemented None. value=6
              Const_77 description=111 BOD 0 If implemented breakpoint interrupt 3 and pulse BRKOUT Signal. BOD 1 If implemented breakpoint interrupt 3. If not implemented None. value=7
          BBM description=Break Before Make BBM or Break After Make BAM Selection BBM lsb=3 msb=3 access=read-write
            enumeratedValues
              Const_00 description=0 Break after make BAM . value=0
              Const_11 description=1 Break before make BBM . value=1
          BOD description=Breakout Disable BOD lsb=4 msb=4 access=read-write
            enumeratedValues
              Const_00 description=0 BRKOUT signal asserted according to the action specified in the EVTA field. value=0
              Const_11 description=1 BRKOUT signal not asserted. This takes priority over any assertion generated by the EVTA field. value=1
          SUSP description=CDC Suspend Out Signal State SUSP. Value to be assigned to the CDC suspend out signal when the event is raised. lsb=5 msb=5 access=read-write
          CNT description=Counter CNT. When this event occurs adjust the control of the performance counters in task mode as follows lsb=6 msb=7 access=read-write
            enumeratedValues
              Const_00 description=00 No change. value=0
              Const_11 description=01 Start the performance counters. value=1
              Const_22 description=10 Stop the performance counters. value=2
              Const_33 description=11 Toggle the performance counter control i.e. start it if it is currently stopped stop it if it is currently running . value=3
      TRIG_ACC description=CPUx TriggerAddressx resetvalue={Debug Reset:0x0} addressOffset=64816 size=32 resetValue=0 resetMask=4294967295
        fields
          T0 description=Trigger 0 T0. active since last cleared lsb=0 msb=0 access=read-only
          T1 description=Trigger 1 T1. active since last cleared lsb=1 msb=1 access=read-only
          T2 description=Trigger 2 T2. active since last cleared lsb=2 msb=2 access=read-only
          T3 description=Trigger 3 T3. active since last cleared lsb=3 msb=3 access=read-only
          T4 description=Trigger 4 T4. active since last cleared lsb=4 msb=4 access=read-only
          T5 description=Trigger 5 T5. active since last cleared lsb=5 msb=5 access=read-only
          T6 description=Trigger 6 T6. active since last cleared lsb=6 msb=6 access=read-only
          T7 description=Trigger 7 T7. active since last cleared lsb=7 msb=7 access=read-only
      DMS description=CPUx Debug Monitor Start Address resetvalue={Application Reset:0x0} addressOffset=64832 size=32 resetValue=0 resetMask=0
        fields
          DMSValue description=Debug Monitor Start Address DMSValue. The address at which monitor code execution begins when a breakpoint trap is taken. lsb=1 msb=31 access=read-write
      DCX description=CPUx Debug Context Save Area Pointer resetvalue={Application Reset:0x0} addressOffset=64836 size=32 resetValue=0 resetMask=0
        fields
          DCXValue description=Debug Context Save Area Pointer DCXValue. Address where the debug context is stored following a breakpoint trap. lsb=6 msb=31 access=read-write
      DBGTCR description=CPUx Debug Trap Control Register resetvalue={Application Reset:0x1} addressOffset=64840 size=32 resetValue=1 resetMask=4294967295
        fields
          DTA description=Debug Trap Active Bit DTA. A breakpoint trap may only be taken in the condition DTA 0. Taking a breakpoint trap sets the DTA bit to one. Further breakpoint traps are therefore disabled until such time as the breakpoint trap handler clears the DTA bit or until the breakpoint trap handler terminates with a RFM. lsb=0 msb=0 access=read-write
            enumeratedValues
              Const_00 description=0 No breakpoint trap is active. value=0
              Const_11 description=1 A breakpoint Trap is active value=1
      SEGEN description=CPUx SRI Error Generation Register resetvalue={Application Reset:0x0} addressOffset=4144 size=32 resetValue=0 resetMask=4294967295
        fields
          ADFLIP description=Address ECC Bit Flip ADFLIP. SRI address ECC Bits to be flipped on the next read or write transaction from the DMI when enabled by AE. lsb=0 msb=7 access=read-write
            enumeratedValues
              Const_00 description=0 No Flip value=0
              Const_11 description=1 Flip value=1
          ADTYPE description=Type of error ADTYPE lsb=8 msb=9 access=read-write
            enumeratedValues
              Const_00 description=00 Data Master Address Phase value=0
              Const_11 description=01 Data Master Write Data value=1
              Const_22 description=10 Data Slave Read Data value=2
          AE description=Activate Error Enable AE. Enabled the selective inverting of SRI ECC packet bits defined by ADFLIP. This bit will be cleared by hardware after the next SRI read or write transaction from the DMI. lsb=31 msb=31 access=read-write
            enumeratedValues
              Const_00 description=0 Not Enabled value=0
              Const_11 description=1 Enabled value=1
      DCON2 description=CPUx Data Control Register 2 resetvalue={Application Reset:0x0} addressOffset=36864 size=32 resetValue=0 resetMask=0
        fields
          DCACHE_SZE description=Data Cache Size DCACHE SZE. In KBytes lsb=0 msb=15 access=read-only
          DSCRATCH_SZE description=Data Scratch Size DSCRATCH SZE. In KBytes lsb=16 msb=31 access=read-only
      DSTR description=CPUx Data Synchronous Trap Register resetvalue={Application Reset:0x0} addressOffset=36880 size=32 resetValue=0 resetMask=4294967295
        fields
          SRE description=Scratch Range Error SRE. A scratch Range Error occurs whenever an access to the data scratch is outside the range of the SRAM. lsb=0 msb=0 access=read-write
          GAE description=Global Address Error GAE. Load or store to local code scratch address outside of the lower 1MByte. lsb=1 msb=1 access=read-write
          LBE description=Load Bus Error LBE. A Load Bus Error will be set whenever the SRI flags an error due a load from external memory. lsb=2 msb=2 access=read-write
          DRE description=Local DLMU Range Error DRE. A DLMU Range Error occurs whenever an access to the local DLMU region is outside the physically implemented memory. lsb=3 msb=3 access=read-write
          CRE description=Cache Refill Error CRE. A Cache Refill Error will be set whenever the SRI flags an error due a cache refill from external memory. lsb=6 msb=6 access=read-write
          DTME description=DTAG MSIST Error DTME. Access to memory mapped DTAG range outside of physically implemented memory. lsb=14 msb=14 access=read-write
          LOE description=Load Overlay Error LOE. Load to invalid overlay address. lsb=15 msb=15 access=read-write
          SDE description=Segment Difference Error SDE. Load or store access where base address is in different segment to access address. lsb=16 msb=16 access=read-write
          SCE description=Segment Crossing Error SCE. Load or store access across segment boundary. lsb=17 msb=17 access=read-write
          CAC description=CSFR Access Error CAC. Load or store to local CSFR space. lsb=18 msb=18 access=read-write
          MPE description=Memory Protection Error MPE. Data access violating memory protection. lsb=19 msb=19 access=read-write
          CLE description=Context Location Error CLE. Context operation to invalid location. lsb=20 msb=20 access=read-write
          ALN description=Alignment Error ALN. Data access causing alignment error. lsb=24 msb=24 access=read-write
      DATR description=CPUx Data Asynchronous Trap Register resetvalue={Application Reset:0x0} addressOffset=36888 size=32 resetValue=0 resetMask=4294967295
        fields
          SBE description=Store Bus Error SBE lsb=3 msb=3 access=read-write
          CWE description=Cache Writeback Error CWE lsb=9 msb=9 access=read-write
          CFE description=Cache Flush Error CFE lsb=10 msb=10 access=read-write
          SOE description=Store Overlay Error SOE lsb=14 msb=14 access=read-write
      DEADD description=CPUx Data Error Address Register resetvalue={Application Reset:0x0} addressOffset=36892 size=32 resetValue=0 resetMask=4294967295
        fields
          ERROR_ADDRESS description=Error Address ERROR ADDRESS lsb=0 msb=31 access=read-only
      DCON0 description=CPUx Data Memory Control Register resetvalue={Application Reset:0x2} addressOffset=36928 size=32 resetValue=2 resetMask=4294967295
        fields
          DCBYP description=Data Cache Bypass DCBYP lsb=1 msb=1 access=read-write
            enumeratedValues
              Const_00 description=0 DCache DRB enabled value=0
              Const_11 description=1 DCache DRB Bypass disabled value=1
      PSTR description=CPUx Program Synchronous Trap Register resetvalue={Application Reset:0x0} addressOffset=37376 size=32 resetValue=0 resetMask=4294967295
        fields
          FRE description=Fetch Range Error FRE. A Fetch Range Error occurs whenever an access to the Program Scratch is outside the range of the SRAM. lsb=0 msb=0 access=read-write
          FBE description=Fetch Bus Error FBE. A Fetch bus error will be set whenever the SRI flags an error due a fetch from external memory. This will be set for both direct fetches from the bus and for cache refills. lsb=2 msb=2 access=read-write
          FPE description=Fetch Peripheral Error FPE. A Fetch peripheral error will be flagged whenever a fetch is attempted to peripheral space. lsb=12 msb=12 access=read-write
          FME description=Fetch MSIST Error FME. During SIST mode a fetch from the PTAG will cause a PSE trap to occur. lsb=14 msb=14 access=read-write
      PCON1 description=CPUx Program Control 1 resetvalue={Application Reset:0x0} addressOffset=37380 size=32 resetValue=0 resetMask=4294967295
        fields
          PCINV description=Program Cache Invalidate PCINV lsb=0 msb=0 access=read-write
            enumeratedValues
              Const_00 description=0 Write No effect normal instruction cache operation. Read Normal operation instruction cache available value=0
              Const_11 description=1 Write Initiate invalidation of entire instruction cache. Read Instruction cache invalidation in progress. Instruction cache unavailable. value=1
          PBINV description=Program Buffer Invalidate PBINV. Write Operation This field returns 0 when read. lsb=1 msb=1 access=read-write
            enumeratedValues
              Const_00 description=0 Write No effect. Normal program line buffer operation. value=0
              Const_11 description=1 Write Invalidate the program line buffer. value=1
      PCON2 description=CPUx Program Control 2 resetvalue={Application Reset:0x0} addressOffset=37384 size=32 resetValue=0 resetMask=0
        fields
          PCACHE_SZE description=Program Cache Size ICACHE in KBytes PCACHE SZE. In KBytes lsb=0 msb=15 access=read-only
          PSCRATCH_SZE description=Program Scratch Size in KBytes PSCRATCH SZE. In KBytes lsb=16 msb=31 access=read-only
      PCON0 description=CPUx Program Control 0 resetvalue={Application Reset:0x2} addressOffset=37388 size=32 resetValue=2 resetMask=4294967295
        fields
          PCBYP description=Program Cache Bypass PCBYP lsb=1 msb=1 access=read-write
            enumeratedValues
              Const_00 description=0 Cache enabled value=0
              Const_11 description=1 Cache bypass disabled value=1
  CPU1 version=100 description=CPU alternatePeripheral=CPU0 baseAddress=0
    offset=0 size=65472 usage=registers
    registers
      DPR[%s] dim=18 dimIncrement=8 description=DPR addressOffset=49152
        DPRy_L description=CPUx Data Protection Range 0 Lower Bound Register resetvalue={Application Reset:0x0} addressOffset=0 size=32 resetValue=0 resetMask=4294967295
          fields
            LOWBND description=DPRy Lower Boundary Address LOWBND lsb=3 msb=31 access=read-write
        DPRy_U description=CPUx Data Protection Range 0 Upper Bound Register resetvalue={Application Reset:0x0} addressOffset=4 size=32 resetValue=0 resetMask=4294967295
          fields
            UPPBND description=DPRy Upper Boundary Address UPPBND lsb=3 msb=31 access=read-write
      CPR[%s] dim=10 dimIncrement=8 description=CPR addressOffset=53248
        CPRy_L description=CPUx Code Protection Range 0 Lower Bound Register resetvalue={Application Reset:0x0} addressOffset=0 size=32 resetValue=0 resetMask=4294967295
          fields
            LOWBND description=CPRy Lower Boundary Address LOWBND lsb=5 msb=31 access=read-write
        CPRy_U description=CPUx Code Protection Range 0 Upper Bound Register resetvalue={Application Reset:0x0} addressOffset=4 size=32 resetValue=0 resetMask=4294967295
          fields
            UPPBND description=CPR0 m Upper Boundary Address UPPBND lsb=5 msb=31 access=read-write
      TPS description=TPS addressOffset=58368
        CON description=CPUx Temporal Protection System Control Register resetvalue={Application Reset:0x0} addressOffset=0 size=32 resetValue=0 resetMask=4294967295
          fields
            TEXP0 description=Timer0 Expired Flag TEXP0. Set when the corresponding timer expires. Cleared on any write to the TIMER0 register. lsb=0 msb=0 access=read-only
            TEXP1 description=Timer1 Expired Flag TEXP1. Set when the corresponding timer expires. Cleared on any write to the TIMER1 register. lsb=1 msb=1 access=read-only
            TEXP2 description=Timer1 Expired Flag TEXP2. Set when the corresponding timer expires. Cleared on any write to the TIMER1 register. lsb=2 msb=2 access=read-only
            TTRAP description=Temporal Protection Trap TTRAP. If set indicates that a TAE trap has been requested. Any subsequent TAE traps are disabled. A write clears the flag and re enables TAE traps. lsb=16 msb=16 access=read-only
        TIMER[%s] dim=3 dimIncrement=4 description=CPUx Temporal Protection System Timer Register 0 resetvalue={Application Reset:0x0} addressOffset=4 size=32 resetValue=0 resetMask=4294967295
          fields
            Timer description=Temporal Protection Timer Timer. Writing zero de activates the Timer. Writing a non zero value starts the Timer. Any write clears the corresponding TPS CON.TEXP flag. Read returns the current Timer value. lsb=0 msb=31 access=read-write
      TPS_EXTIM description=TPS EXTIM addressOffset=58432
        ENTRY_LVAL description=CPUx Exception Entry Timer Load Value resetvalue={Application Reset:0x0} addressOffset=0 size=32 resetValue=0 resetMask=4294967295
          fields
            ENTRY_LVAL description=Exception Entry Timer Load value ENTRY LVAL. Value loaded into the exception entry timer on detection of an enabled exception. Bits 3 0 are constrained to be 0 lsb=4 msb=11 access=read-write
        ENTRY_CVAL description=CPUx Exception Entry Timer Current Value resetvalue={Application Reset:0x0} addressOffset=4 size=32 resetValue=0 resetMask=4294967295
          fields
            ENTRY_CVAL description=Exception Entry Timer Current Value ENTRY CVAL. Current value of the exception entry timer. lsb=0 msb=11 access=read-only
        EXIT_LVAL description=CPUx Exception Exit Timer Load Value resetvalue={Application Reset:0x0} addressOffset=8 size=32 resetValue=0 resetMask=4294967295
          fields
            EXIT_LVAL description=Exception Exit Timer Load value EXIT LVAL. Value loaded into the exception exit timer on detection of an enabled exception. Bits 3 0 are constrained to be 0 lsb=4 msb=23 access=read-write
        EXIT_CVAL description=CPUx Exception Exit Timer Current Value resetvalue={Application Reset:0x0} addressOffset=12 size=32 resetValue=0 resetMask=4294967295
          fields
            EXIT_CVAL description=Exception Exit Timer Current Value EXIT CVAL. Current value of the exception exit timer. lsb=0 msb=23 access=read-only
        CLASS_EN description=CPUx Exception Timer Class Enable Register resetvalue={Application Reset:0x0} addressOffset=16 size=32 resetValue=0 resetMask=4294967295
          fields
            EXTIM_CLASS_EN description=Exception Timer Class Enables EXTIM CLASS EN. Trap Class enables for exception timer. lsb=0 msb=7 access=read-write
        STAT description=CPUx Exception Timer Status Register resetvalue={Application Reset:0x0} addressOffset=20 size=32 resetValue=0 resetMask=4294967295
          fields
            EXIT_TIN description=Exception Exit Timer TIN EXIT TIN. Exception Exit Timer TIN of triggering trap. lsb=0 msb=7 access=read-write
            EXIT_CLASS description=Exception Exit Timer Class EXIT CLASS. Exception exit Timer Class of triggering trap. lsb=8 msb=10 access=read-write
            EXIT_AT description=Exception Exit Timer Alarm Triggered EXIT AT. Exception Exit Timer Alarm triggered sticky bit. Alarm triggered since last cleared. lsb=15 msb=15 access=read-only
            ENTRY_TIN description=Exception Entry Timer TIN ENTRY TIN. Exception Entry Timer TIN of triggering trap. lsb=16 msb=23 access=read-write
            ENTRY_CLASS description=Exception Entry Timer Class ENTRY CLASS. Exception Entry Timer Class of triggering trap. lsb=24 msb=26 access=read-write
            ENTRY_AT description=Exception Entry Timer Alarm Triggered ENTRY AT. Exception Entry Timer Alarm triggered sticky bit. Alarm triggered since last cleared. lsb=31 msb=31 access=read-only
        FCX description=CPUx Exception Timer FCX Register resetvalue={Application Reset:0x0} addressOffset=24 size=32 resetValue=0 resetMask=4294967295
          fields
            EXIT_FCX description=Exception Exit Timer FCX EXIT FCX. Exception Exit Timer FCX of triggering trap. lsb=0 msb=19 access=read-only
      FPU_TRAP description=FPU TRAP addressOffset=40960
        CON description=CPUx Trap Control Register resetvalue={Application Reset:0x0} addressOffset=0 size=32 resetValue=0 resetMask=4294967295
          fields
            TST description=Trap Status TST lsb=0 msb=0 access=read-only
              enumeratedValues
                Const_00 description=0 No instruction captured. The next enabled exception will cause the exceptional instruction to be captured. value=0
                Const_11 description=1 Instruction captured. No further enabled exceptions will be captured until TST is cleared. value=1
            TCL description=Trap Clear TCL. Read always reads as 0. lsb=1 msb=1 access=write-only
              enumeratedValues
                Const_00 description=0 No effect. value=0
                Const_11 description=1 Clears the trapped instruction TST will be negated . value=1
            RM description=Captured Rounding Mode RM. The rounding mode of the captured instruction. Only valid when TST is asserted. Note that this is the rounding mode supplied to the FPU for the exceptional instruction. UPDFL instructions may cause a trap and change the rounding mode. In this case the RM bits capture the input rounding mode lsb=8 msb=9 access=read-only
            FXE description=FX Trap Enable FXE. When set an instruction generating an FX exception will trigger a trap. lsb=18 msb=18 access=read-write
            FUE description=FU Trap Enable FUE. When set an instruction generating an FU exception will trigger a trap. lsb=19 msb=19 access=read-write
            FZE description=FZ Trap Enable FZE. When set an instruction generating an FZ exception will trigger a trap. lsb=20 msb=20 access=read-write
            FVE description=FV Trap Enable FVE. When set an instruction generating an FV exception will trigger a trap. lsb=21 msb=21 access=read-write
