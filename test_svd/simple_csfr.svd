# ARM_Example register map
Vendor: Infineon; Series: ARMCM3; File version: 1.2
CPU: CM3 r1p0, little endian, MPU, FPU, 3 interrupt priority bits

## Further device data (continued)
              Const_11 description=01 Request pending lowest priority. value=1
              Const_255255 description=FF Request pending highest priority. value=255
      FCX description=CPUx Free CSA List Head Pointer resetvalue={Application Reset:0x0} addressOffset=65080 size=32 resetValue=0 resetMask=4294967295
        fields
          FCXO description=FCX Offset Address Field FCXO. The FCXO and FCXS fields together form the FCX pointer which points to the next available CSA. lsb=0 msb=15 access=read-write
          FCXS description=FCX Segment Address Field FCXS. Used in conjunction with the FCXO field. lsb=16 msb=19 access=read-write
      LCX description=CPUx Free CSA List Limit Pointer resetvalue={Application Reset:0x0} addressOffset=65084 size=32 resetValue=0 resetMask=4294967295
        fields
          LCXO description=LCX Offset Field LCXO. The LCXO and LCXS fields form the pointer LCX which points to the last available CSA. lsb=0 msb=15 access=read-write
          LCXS description=LCX Segment Address LCXS. This field is used in conjunction with the LCXO field. lsb=16 msb=19 access=read-write
      CUS_ID description=CPUx Customer ID register resetvalue={Application Reset:0x0} addressOffset=65104 size=32 resetValue=0 resetMask=4294967288
        fields
          CID description=Customer ID CID. See CROSSREFERENCE for the relation between CUS ID and CORE ID for each derivative lsb=0 msb=2 access=read-only
      Dy[%s] dim=16 dimIncrement=4 description=CPUx Data General Purpose Register 0 resetvalue={Application Reset:0x0} addressOffset=65280 size=32 resetValue=0 resetMask=0
        fields
          DATA description=Data Register DATA. General purpose registers lsb=0 msb=31 access=read-write
      Ay[%s] dim=16 dimIncrement=4 description=CPUx Address General Purpose Register 0 resetvalue={Application Reset:0x0} addressOffset=65408 size=32 resetValue=0 resetMask=0
        fields
          ADDR description=Address Register ADDR. General purpose registers lsb=0 msb=31 access=read-write
      CPXE_0 description=CPUx Code Protection Execute Enable Register Set 3 resetvalue={Application Reset:0x0} addressOffset=57344 size=32 resetValue=0 resetMask=4294967295
        fields
          XE_n description=Execute Enable Range select XE n lsb=0 msb=9 access=read-write
            enumeratedValues
              Const_00 description=0 Code Protection Range n not enabled for execution value=0
              Const_11 description=1 Code Protection Range n enabled for execution value=1
      CPXE_1 description=CPUx Code Protection Execute Enable Register Set 3 resetvalue={Application Reset:0x0} addressOffset=57348 size=32 resetValue=0 resetMask=4294967295
        fields
          XE_n description=Execute Enable Range select XE n lsb=0 msb=9 access=read-write
            enumeratedValues
              Const_00 description=0 Code Protection Range n not enabled for execution value=0
              Const_11 description=1 Code Protection Range n enabled for execution value=1
      CPXE_2 description=CPUx Code Protection Execute Enable Register Set 3 resetvalue={Application Reset:0x0} addressOffset=57352 size=32 resetValue=0 resetMask=4294967295
        fields
          XE_n description=Execute Enable Range select XE n lsb=0 msb=9 access=read-write
            enumeratedValues
              Const_00 description=0 Code Protection Range n not enabled for execution value=0
              Const_11 description=1 Code Protection Range n enabled for execution value=1
      CPXE_3 description=CPUx Code Protection Execute Enable Register Set 3 resetvalue={Application Reset:0x0} addressOffset=57356 size=32 resetValue=0 resetMask=4294967295
        fields
          XE_n description=Execute Enable Range select XE n lsb=0 msb=9 access=read-write
            enumeratedValues
              Const_00 description=0 Code Protection Range n not enabled for execution value=0
              Const_11 description=1 Code Protection Range n enabled for execution value=1
      DPRE_0 description=CPUx Data Protection Read Enable Register Set 3 resetvalue={Application Reset:0x0} addressOffset=57360 size=32 resetValue=0 resetMask=4294967295
        fields
          RE_n description=Read Enable Range Select RE n lsb=0 msb=17 access=read-write
            enumeratedValues
              Const_00 description=0 Data Protection Range n not enabled for data read value=0
              Const_11 description=1 Data Protection Range n enabled for data read value=1
      DPRE_1 description=CPUx Data Protection Read Enable Register Set 3 resetvalue={Application Reset:0x0} addressOffset=57364 size=32 resetValue=0 resetMask=4294967295
        fields
          RE_n description=Read Enable Range Select RE n lsb=0 msb=17 access=read-write
            enumeratedValues
              Const_00 description=0 Data Protection Range n not enabled for data read value=0
              Const_11 description=1 Data Protection Range n enabled for data read value=1
      DPRE_2 description=CPUx Data Protection Read Enable Register Set 3 resetvalue={Application Reset:0x0} addressOffset=57368 size=32 resetValue=0 resetMask=4294967295
        fields
          RE_n description=Read Enable Range Select RE n lsb=0 msb=17 access=read-write
            enumeratedValues
              Const_00 description=0 Data Protection Range n not enabled for data read value=0
              Const_11 description=1 Data Protection Range n enabled for data read value=1
      DPRE_3 description=CPUx Data Protection Read Enable Register Set 3 resetvalue={Application Reset:0x0} addressOffset=57372 size=32 resetValue=0 resetMask=4294967295
        fields
          RE_n description=Read Enable Range Select RE n lsb=0 msb=17 access=read-write
            enumeratedValues
              Const_00 description=0 Data Protection Range n not enabled for data read value=0
              Const_11 description=1 Data Protection Range n enabled for data read value=1
      DPWE_0 description=CPUx Data Protection Write Enable Register Set 3 resetvalue={Application Reset:0x0} addressOffset=57376 size=32 resetValue=0 resetMask=4294967295
        fields
          WE_n description=Write Enable Range Select WE n lsb=0 msb=17 access=read-write
            enumeratedValues
              Const_00 description=0 Data Protection Range n not enabled for data write value=0
              Const_11 description=1 Data Protection Range n enabled for data write value=1
      DPWE_1 description=CPUx Data Protection Write Enable Register Set 3 resetvalue={Application Reset:0x0} addressOffset=57380 size=32 resetValue=0 resetMask=4294967295
        fields
          WE_n description=Write Enable Range Select WE n lsb=0 msb=17 access=read-write
            enumeratedValues
              Const_00 description=0 Data Protection Range n not enabled for data write value=0
              Const_11 description=1 Data Protection Range n enabled for data write value=1
      DPWE_2 description=CPUx Data Protection Write Enable Register Set 3 resetvalue={Application Reset:0x0} addressOffset=57384 size=32 resetValue=0 resetMask=4294967295
        fields
          WE_n description=Write Enable Range Select WE n lsb=0 msb=17 access=read-write
            enumeratedValues
              Const_00 description=0 Data Protection Range n not enabled for data write value=0
              Const_11 description=1 Data Protection Range n enabled for data write value=1
      DPWE_3 description=CPUx Data Protection Write Enable Register Set 3 resetvalue={Application Reset:0x0} addressOffset=57388 size=32 resetValue=0 resetMask=4294967295
        fields
          WE_n description=Write Enable Range Select WE n lsb=0 msb=17 access=read-write
            enumeratedValues
              Const_00 description=0 Data Protection Range n not enabled for data write value=0
              Const_11 description=1 Data Protection Range n enabled for data write value=1
      CPXE_4 description=CPUx Code Protection Execute Enable Register Set 5 resetvalue={Application Reset:0x0} addressOffset=57408 size=32 resetValue=0 resetMask=4294967295
        fields
          XE_n description=Execute Enable Range select XE n lsb=0 msb=9 access=read-write
            enumeratedValues
              Const_00 description=0 Code Protection Range n not enabled for execution value=0
              Const_11 description=1 Code Protection Range n enabled for execution value=1
      CPXE_5 description=CPUx Code Protection Execute Enable Register Set 5 resetvalue={Application Reset:0x0} addressOffset=57412 size=32 resetValue=0 resetMask=4294967295
        fields
          XE_n description=Execute Enable Range select XE n lsb=0 msb=9 access=read-write
            enumeratedValues
              Const_00 description=0 Code Protection Range n not enabled for execution value=0
              Const_11 description=1 Code Protection Range n enabled for execution value=1
      DPRE_4 description=CPUx Data Protection Read Enable Register Set 5 resetvalue={Application Reset:0x0} addressOffset=57424 size=32 resetValue=0 resetMask=4294967295
        fields
          RE_n description=Read Enable Range Select RE n lsb=0 msb=17 access=read-write
            enumeratedValues
              Const_00 description=0 Data Protection Range n not enabled for data read value=0
              Const_11 description=1 Data Protection Range n enabled for data read value=1
      DPRE_5 description=CPUx Data Protection Read Enable Register Set 5 resetvalue={Application Reset:0x0} addressOffset=57428 size=32 resetValue=0 resetMask=4294967295
        fields
          RE_n description=Read Enable Range Select RE n lsb=0 msb=17 access=read-write
            enumeratedValues
              Const_00 description=0 Data Protection Range n not enabled for data read value=0
              Const_11 description=1 Data Protection Range n enabled for data read value=1
      DPWE_4 description=CPUx Data Protection Write Enable Register Set 5 resetvalue={Application Reset:0x0} addressOffset=57440 size=32 resetValue=0 resetMask=4294967295
        fields
          WE_n description=Write Enable Range Select WE n lsb=0 msb=17 access=read-write
            enumeratedValues
              Const_00 description=0 Data Protection Range n not enabled for data write value=0
              Const_11 description=1 Data Protection Range n enabled for data write value=1
      DPWE_5 description=CPUx Data Protection Write Enable Register Set 5 resetvalue={Application Reset:0x0} addressOffset=57444 size=32 resetValue=0 resetMask=4294967295
        fields
          WE_n description=Write Enable Range Select WE n lsb=0 msb=17 access=read-write
            enumeratedValues
              Const_00 description=0 Data Protection Range n not enabled for data write value=0
              Const_11 description=1 Data Protection Range n enabled for data write value=1
      CCTRL description=CPUx Counter Control resetvalue={Debug Reset:0x0} addressOffset=64512 size=32 resetValue=0 resetMask=4294967295
        fields
          CM description=Counter Mode CM lsb=0 msb=0 access=read-write
            enumeratedValues
              Const_00 description=0 Normal Mode. value=0
              Const_11 description=1 Task Mode. value=1
          CE description=Count Enable CE lsb=1 msb=1 access=read-write
            enumeratedValues
              Const_00 description=0 Disable the counters CCNT ICNT M1CNT M2CNT M3CNT. value=0
              Const_11 description=1 Enable the counters CCNT ICNT M1CNT M2CNT M3CNT. value=1
          M1 description=M1CNT Configuration M1 lsb=2 msb=4 access=read-write
          M2 description=M2CNT Configuration M2 lsb=5 msb=7 access=read-write
          M3 description=M3CNT Configuration M3 lsb=8 msb=10 access=read-write
      CCNT description=CPUx CPU Clock Cycle Count resetvalue={Debug Reset:0x0} addressOffset=64516 size=32 resetValue=0 resetMask=4294967295
        fields
          CountValue description=Count Value CountValue. Current Count of the CPU Clock Cycles. lsb=0 msb=30 access=read-write
          SOvf description=Sticky Overflow Bit SOvf. This bit is set by hardware when count value 30 0 31 h7FFF FFFF. It can only be cleared by software. lsb=31 msb=31 access=read-write
      ICNT description=CPUx Instruction Count resetvalue={Debug Reset:0x0} addressOffset=64520 size=32 resetValue=0 resetMask=4294967295
        fields
          CountValue description=Count Value CountValue. Count of the Instructions Executed. lsb=0 msb=30 access=read-write
          SOvf description=Sticky Overflow Bit SOvf. This bit is set by hardware when count value 30 0 31 h7FFF FFFF. It can only be cleared by software. lsb=31 msb=31 access=read-write
      M1CNT description=CPUx Multi Count Register 1 resetvalue={Debug Reset:0x0} addressOffset=64524 size=32 resetValue=0 resetMask=4294967295
        fields
          CountValue description=Count Value CountValue. Count of the Selected Event. lsb=0 msb=30 access=read-write
          SOvf description=Sticky Overflow Bit SOvf. This bit is set by hardware when count value 30 0 31 h7FFF FFFF. It can only be cleared by software. lsb=31 msb=31 access=read-write
      M2CNT description=CPUx Multi Count Register 2 resetvalue={Debug Reset:0x0} addressOffset=64528 size=32 resetValue=0 resetMask=4294967295
        fields
          CountValue description=Count Value CountValue. Count of the Selected Event. lsb=0 msb=30 access=read-write
          SOvf description=Sticky Overflow Bit SOvf. This bit is set by hardware when count value 30 0 31 h7FFF FFFF. It can only be cleared by software. lsb=31 msb=31 access=read-write
      M3CNT description=CPUx Multi Count Register 3 resetvalue={Debug Reset:0x0} addressOffset=64532 size=32 resetValue=0 resetMask=4294967295
        fields
          CountValue description=Count Value CountValue. Count of the Selected Event. lsb=0 msb=30 access=read-write
          SOvf description=Sticky Overflow Bit SOvf. This bit is set by hardware when count value 30 0 31 h7FFF FFFF. It can only be cleared by software. lsb=31 msb=31 access=read-write
      DBGSR description=CPUx Debug Status Register resetvalue={Debug Reset:0x0} addressOffset=64768 size=32 resetValue=0 resetMask=4294967295
        fields
          DE description=Debug Enable DE. Determines whether the CDC is enabled or not. lsb=0 msb=0 access=read-only
            enumeratedValues
              Const_00 description=0 The CDC is disabled. value=0
              Const_11 description=1 The CDC is enabled. value=1
          HALT description=CPU Halt Request Status Field HALT. HALT can be set or cleared by software. HALT 0 is the actual Halt bit. HALT 1 is a mask bit to specify whether or not HALT 0 is to be updated on a software write. HALT 1 is always read as 0. HALT 1 must be set to 1 in order to update HALT 0 by software R read W write . lsb=1 msb=2 access=read-write
            enumeratedValues
              Const_00 description=00 R CPU running. W HALT 0 unchanged. value=0
              Const_11 description=01 R CPU halted. W HALT 0 unchanged. value=1
              Const_22 description=10 R Not Applicable. W reset HALT 0 . value=2
              Const_33 description=11 R Not Applicable. W If DBGSR.DE 1 The CDC is enabled set HALT 0 . If DBGSR.DE 0 The CDC is not enabled HALT 0 is left unchanged. value=3
          SIH description=Suspend in Halt SIH. State of the Suspend In signal. lsb=3 msb=3 access=read-only
            enumeratedValues
              Const_00 description=0 The Suspend In signal is negated. The CPU is not in Halt Mode except when the Halt mechanism is set following a Debug Event or a write to DBGSR.HALT . value=0
              Const_11 description=1 The Suspend In signal is asserted. The CPU is in Halt Mode. value=1
          SUSP description=Current State of the Core Suspend Out Signal SUSP lsb=4 msb=4 access=read-write
            enumeratedValues
              Const_00 description=0 Core suspend out inactive. value=0
              Const_11 description=1 Core suspend out active. value=1
          PREVSUSP description=Previous State of Core Suspend Out Signal PREVSUSP. Updated when a Debug Event causes a hardware update of DBGSR.SUSP. This field is not updated for writes to DBGSR.SUSP. lsb=6 msb=6 access=read-only
            enumeratedValues
              Const_00 description=0 Previous core suspend out inactive. value=0
              Const_11 description=1 Previous core suspend out active. value=1
          PEVT description=Posted Event PEVT lsb=7 msb=7 access=read-write
            enumeratedValues
              Const_00 description=0 No posted event. value=0
              Const_11 description=1 Posted event. value=1
      EXEVT description=CPUx External Event Register resetvalue={Debug Reset:0x0} addressOffset=64776 size=32 resetValue=0 resetMask=4294967295
        fields
          EVTA description=Event Associated EVTA. Specifies the Debug Action associated with the Debug Event lsb=0 msb=2 access=read-write
            enumeratedValues
              Const_00 description=000 BOD 0 Disabled. BOD 1 Disabled. value=0
              Const_11 description=001 BOD 0 Pulse BRKOUT Signal. BOD 1 None. value=1
              Const_22 description=010 BOD 0 Halt and pulse BRKOUT Signal. BOD 1 Halt. value=2
              Const_33 description=011 BOD 0 Breakpoint trap and pulse. BRKOUT Signal. BOD 1 Breakpoint trap. value=3
              Const_44 description=100 BOD 0 Breakpoint interrupt 0 and pulse BRKOUT Signal. BOD 1 Breakpoint interrupt 0. value=4
              Const_55 description=101 BOD 0 If implemented breakpoint interrupt 1 and pulse BRKOUT Signal. BOD 1 If implemented breakpoint interrupt 1. If not implemented None. value=5
              Const_66 description=110 BOD 0 If implemented breakpoint interrupt 2 and pulse BRKOUT Signal. BOD 1 If implemented breakpoint interrupt 2. If not implemented None. value=6
              Const_77 description=111 BOD 0 If implemented breakpoint interrupt 3 and pulse BRKOUT Signal. BOD 1 If implemented breakpoint interrupt 3. If not implemented None. value=7
          BBM description=Break Before Make BBM or Break After Make BAM Selection BBM lsb=3 msb=3 access=read-write
            enumeratedValues
              Const_00 description=0 Break after make BAM . value=0
              Const_11 description=1 Break before make BBM . value=1
          BOD description=Breakout Disable BOD lsb=4 msb=4 access=read-write
            enumeratedValues
              Const_00 description=0 BRKOUT signal asserted according to the Debug Action specified in the EVTA field. value=0
              Const_11 description=1 BRKOUT signal not asserted. This takes priority over any assertion generated by the EVTA field. value=1
          SUSP description=CDC Suspend Out Signal State SUSP. Value to be assigned to the CDC suspend out signal when the Debug Event is raised. lsb=5 msb=5 access=read-write
          CNT description=Counter CNT. When this event occurs adjust the control of the performance counters in task mode as follows lsb=6 msb=7 access=read-write
            enumeratedValues
              Const_00 description=00 No change. value=0
              Const_11 description=01 Start the performance counters. value=1
              Const_22 description=10 Stop the performance counters. value=2
              Const_33 description=11 Toggle the performance counter control i.e. start it if it is currently stopped stop it if it is currently running . value=3
      CREVT description=CPUx Core Register Access Event resetvalue={Debug Reset:0x0} addressOffset=64780 size=32 resetValue=0 resetMask=4294967295
        fields
          EVTA description=Event Associated EVTA. Debug Action associated with the Debug Event lsb=0 msb=2 access=read-write
            enumeratedValues
              Const_00 description=000 BOD 0 Disabled. BOD 1 Disabled. value=0
              Const_11 description=001 BOD 0 Pulse BRKOUT Signal. BOD 1 None. value=1
              Const_22 description=010 BOD 0 Halt and pulse BRKOUT Signal. BOD 1 Halt. value=2
              Const_33 description=011 BOD 0 Breakpoint trap and pulse BRKOUT Signal. BOD 1 Breakpoint trap. value=3
              Const_44 description=100 BOD 0 Breakpoint interrupt 0 and pulse BRKOUT Signal. BOD 1 Breakpoint interrupt 0. value=4
              Const_55 description=101 BOD 0 If implemented breakpoint interrupt 1 and pulse BRKOUT Signal. BOD 1 If implemented breakpoint interrupt 1. If not implemented None. value=5
              Const_66 description=110 BOD 0 If implemented breakpoint interrupt 2 and pulse BRKOUT Signal. BOD 1 If implemented breakpoint interrupt 2. If not implemented None. value=6
              Const_77 description=111 BOD 0 If implemented breakpoint interrupt 3 and pulse BRKOUT Signal. BOD 1 If implemented breakpoint interrupt 3. If not implemented None. value=7
          BBM description=Break Before Make BBM or Break After Make BAM Selection BBM lsb=3 msb=3 access=read-write
            enumeratedValues
              Const_00 description=0 Break after make BAM . value=0
              Const_11 description=1 Break before make BBM . value=1
          BOD description=Breakout Disable BOD lsb=4 msb=4 access=read-write
            enumeratedValues
              Const_00 description=0 BRKOUT signal asserted according to the action specified in the EVTA field. value=0
              Const_11 description=1 BRKOUT signal not asserted. This takes priority over any assertion generated by the EVTA field. value=1
          SUSP description=CDC Suspend Out Signal State SUSP. Value to be assigned to the CDC suspend out signal when the Debug Event is raised. lsb=5 msb=5 access=read-write
          CNT description=Counter CNT. When this event occurs adjust the control of the performance counters in task mode as follows lsb=6 msb=7 access=read-write
            enumeratedValues
              Const_00 description=00 No change. value=0
              Const_11 description=01 Start the performance counters. value=1
              Const_22 description=10 Stop the performance counters. value=2
              Const_33 description=11 Toggle the performance counter control i.e. start it if it is currently stopped stop it if it is currently running . value=3
      SWEVT description=CPUx Software Debug Event resetvalue={Debug Reset:0x0} addressOffset=64784 size=32 resetValue=0 resetMask=4294967295
        fields
          EVTA description=Event Associated EVTA. Debug Action associated with the Debug Event lsb=0 msb=2 access=read-write
            enumeratedValues
              Const_00 description=000 BOD 0 Disabled. BOD 1 Disabled. value=0
              Const_11 description=001 BOD 0 Pulse BRKOUT Signal. BOD 1 None. value=1
              Const_22 description=010 BOD 0 Halt and pulse BRKOUT Signal. BOD 1 Halt. value=2
              Const_33 description=011 BOD 0 Breakpoint trap and pulse BRKOUT Signal. BOD 1 Breakpoint trap. value=3
              Const_44 description=100 BOD 0 Breakpoint interrupt 0 and pulse BRKOUT Signal. BOD 1 Breakpoint interrupt 0. value=4
              Const_55 description=101 BOD 0 If implemented breakpoint interrupt 1 and pulse BRKOUT Signal. BOD 1 If implemented breakpoint interrupt 1. If not implemented None. value=5
              Const_66 description=110 BOD 0 If implemented breakpoint interrupt 2 and pulse BRKOUT Signal. BOD 1 If implemented breakpoint interrupt 2. If not implemented None. value=6
              Const_77 description=111 BOD 0 If implemented breakpoint interrupt 3 and pulse BRKOUT Signal. BOD 1 If implemented breakpoint interrupt 3. If not implemented None. value=7
          BBM description=Break Before Make BBM or Break After Make BAM Selection BBM lsb=3 msb=3 access=read-write
            enumeratedValues
              Const_00 description=0 Break after make BAM . value=0
              Const_11 description=1 Break before make BBM . value=1
          BOD description=Breakout Disable BOD lsb=4 msb=4 access=read-write
            enumeratedValues
              Const_00 description=0 BRKOUT signal asserted according to the action specified in the EVTA field. value=0
              Const_11 description=1 BRKOUT signal not asserted. This takes priority over any assertion generated by the EVTA field. value=1
          SUSP description=CDC Suspend Out Signal State SUSP. Value to be assigned to the CDC suspend out signal when the event is raised. lsb=5 msb=5 access=read-write
          CNT description=Counter CNT. When this event occurs adjust the control of the performance counters in task mode as follows lsb=6 msb=7 access=read-write
            enumeratedValues
              Const_00 description=00 No change. value=0
              Const_11 description=01 Start the performance counters. value=1
              Const_22 description=10 Stop the performance counters. value=2
              Const_33 description=11 Toggle the performance counter control i.e. start it if it is currently stopped stop it if it is currently running . value=3
      TRIG_ACC description=CPUx TriggerAddressx resetvalue={Debug Reset:0x0} addressOffset=64816 size=32 resetValue=0 resetMask=4294967295
        fields
          T0 description=Trigger 0 T0. active since last cleared lsb=0 msb=0 access=read-only
          T1 description=Trigger 1 T1. active since last cleared lsb=1 msb=1 access=read-only
          T2 description=Trigger 2 T2. active since last cleared lsb=2 msb=2 access=read-only
          T3 description=Trigger 3 T3. active since last cleared lsb=3 msb=3 access=read-only
          T4 description=Trigger 4 T4. active since last cleared lsb=4 msb=4 access=read-only
          T5 description=Trigger 5 T5. active since last cleared lsb=5 msb=5 access=read-only
          T6 description=Trigger 6 T6. active since last cleared lsb=6 msb=6 access=read-only
          T7 description=Trigger 7 T7. active since last cleared lsb=7 msb=7 access=read-only
      DMS description=CPUx Debug Monitor Start Address resetvalue={Application Reset:0x0} addressOffset=64832 size=32 resetValue=0 resetMask=0
        fields
          DMSValue description=Debug Monitor Start Address DMSValue. The address at which monitor code execution begins when a breakpoint trap is taken. lsb=1 msb=31 access=read-write
      DCX description=CPUx Debug Context Save Area Pointer resetvalue={Application Reset:0x0} addressOffset=64836 size=32 resetValue=0 resetMask=0
        fields
          DCXValue description=Debug Context Save Area Pointer DCXValue. Address where the debug context is stored following a breakpoint trap. lsb=6 msb=31 access=read-write
      DBGTCR description=CPUx Debug Trap Control Register resetvalue={Application Reset:0x1} addressOffset=64840 size=32 resetValue=1 resetMask=4294967295
        fields
          DTA description=Debug Trap Active Bit DTA. A breakpoint trap may only be taken in the condition DTA 0. Taking a breakpoint trap sets the DTA bit to one. Further breakpoint traps are therefore disabled until such time as the breakpoint trap handler clears the DTA bit or until the breakpoint trap handler terminates with a RFM. lsb=0 msb=0 access=read-write
            enumeratedValues
              Const_00 description=0 No breakpoint trap is active. value=0
              Const_11 description=1 A breakpoint Trap is active value=1
      SEGEN description=CPUx SRI Error Generation Register resetvalue={Application Reset:0x0} addressOffset=4144 size=32 resetValue=0 resetMask=4294967295
        fields
          ADFLIP description=Address ECC Bit Flip ADFLIP. SRI address ECC Bits to be flipped on the next read or write transaction from the DMI when enabled by AE. lsb=0 msb=7 access=read-write
            enumeratedValues
              Const_00 description=0 No Flip value=0
              Const_11 description=1 Flip value=1
          ADTYPE description=Type of error ADTYPE lsb=8 msb=9 access=read-write
            enumeratedValues
              Const_00 description=00 Data Master Address Phase value=0
              Const_11 description=01 Data Master Write Data value=1
              Const_22 description=10 Data Slave Read Data value=2
          AE description=Activate Error Enable AE. Enabled the selective inverting of SRI ECC packet bits defined by ADFLIP. This bit will be cleared by hardware after the next SRI read or write transaction from the DMI. lsb=31 msb=31 access=read-write
            enumeratedValues
              Const_00 description=0 Not Enabled value=0
              Const_11 description=1 Enabled value=1
      DCON2 description=CPUx Data Control Register 2 resetvalue={Application Reset:0x0} addressOffset=36864 size=32 resetValue=0 resetMask=0
        fields
          DCACHE_SZE description=Data Cache Size DCACHE SZE. In KBytes lsb=0 msb=15 access=read-only
          DSCRATCH_SZE description=Data Scratch Size DSCRATCH SZE. In KBytes lsb=16 msb=31 access=read-only
      DSTR description=CPUx Data Synchronous Trap Register resetvalue={Application Reset:0x0} addressOffset=36880 size=32 resetValue=0 resetMask=4294967295
        fields
          SRE description=Scratch Range Error SRE. A scratch Range Error occurs whenever an access to the data scratch is outside the range of the SRAM. lsb=0 msb=0 access=read-write
          GAE description=Global Address Error GAE. Load or store to local code scratch address outside of the lower 1MByte. lsb=1 msb=1 access=read-write
          LBE description=Load Bus Error LBE. A Load Bus Error will be set whenever the SRI flags an error due a load from external memory. lsb=2 msb=2 access=read-write
          DRE description=Local DLMU Range Error DRE. A DLMU Range Error occurs whenever an access to the local DLMU region is outside the physically implemented memory. lsb=3 msb=3 access=read-write
          CRE description=Cache Refill Error CRE. A Cache Refill Error will be set whenever the SRI flags an error due a cache refill from external memory. lsb=6 msb=6 access=read-write
          DTME description=DTAG MSIST Error DTME. Access to memory mapped DTAG range outside of physically implemented memory. lsb=14 msb=14 access=read-write
          LOE description=Load Overlay Error LOE. Load to invalid overlay address. lsb=15 msb=15 access=read-write
          SDE description=Segment Difference Error SDE. Load or store access where base address is in different segment to access address. lsb=16 msb=16 access=read-write
          SCE description=Segment Crossing Error SCE. Load or store access across segment boundary. lsb=17 msb=17 access=read-write
          CAC description=CSFR Access Error CAC. Load or store to local CSFR space. lsb=18 msb=18 access=read-write
          MPE description=Memory Protection Error MPE. Data access violating memory protection. lsb=19 msb=19 access=read-write
          CLE description=Context Location Error CLE. Context operation to invalid location. lsb=20 msb=20 access=read-write
          ALN description=Alignment Error ALN. Data access causing alignment error. lsb=24 msb=24 access=read-write
      DATR description=CPUx Data Asynchronous Trap Register resetvalue={Application Reset:0x0} addressOffset=36888 size=32 resetValue=0 resetMask=4294967295
        fields
          SBE description=Store Bus Error SBE lsb=3 msb=3 access=read-write
          CWE description=Cache Writeback Error CWE lsb=9 msb=9 access=read-write
          CFE description=Cache Flush Error CFE lsb=10 msb=10 access=read-write
          SOE description=Store Overlay Error SOE lsb=14 msb=14 access=read-write
      DEADD description=CPUx Data Error Address Register resetvalue={Application Reset:0x0} addressOffset=36892 size=32 resetValue=0 resetMask=4294967295
        fields
          ERROR_ADDRESS description=Error Address ERROR ADDRESS lsb=0 msb=31 access=read-only
      DCON0 description=CPUx Data Memory Control Register resetvalue={Application Reset:0x2} addressOffset=36928 size=32 resetValue=2 resetMask=4294967295
        fields
          DCBYP description=Data Cache Bypass DCBYP lsb=1 msb=1 access=read-write
            enumeratedValues
              Const_00 description=0 DCache DRB enabled value=0
              Const_11 description=1 DCache DRB Bypass disabled value=1
      PSTR description=CPUx Program Synchronous Trap Register resetvalue={Application Reset:0x0} addressOffset=37376 size=32 resetValue=0 resetMask=4294967295
        fields
          FRE description=Fetch Range Error FRE. A Fetch Range Error occurs whenever an access to the Program Scratch is outside the range of the SRAM. lsb=0 msb=0 access=read-write
          FBE description=Fetch Bus Error FBE. A Fetch bus error will be set whenever the SRI flags an error due a fetch from external memory. This will be set for both direct fetches from the bus and for cache refills. lsb=2 msb=2 access=read-write
          FPE description=Fetch Peripheral Error FPE. A Fetch peripheral error will be flagged whenever a fetch is attempted to peripheral space. lsb=12 msb=12 access=read-write
          FME description=Fetch MSIST Error FME. During SIST mode a fetch from the PTAG will cause a PSE trap to occur. lsb=14 msb=14 access=read-write
      PCON1 description=CPUx Program Control 1 resetvalue={Application Reset:0x0} addressOffset=37380 size=32 resetValue=0 resetMask=4294967295
        fields
          PCINV description=Program Cache Invalidate PCINV lsb=0 msb=0 access=read-write
            enumeratedValues
              Const_00 description=0 Write No effect normal instruction cache operation. Read Normal operation instruction cache available value=0
              Const_11 description=1 Write Initiate invalidation of entire instruction cache. Read Instruction cache invalidation in progress. Instruction cache unavailable. value=1
          PBINV description=Program Buffer Invalidate PBINV. Write Operation This field returns 0 when read. lsb=1 msb=1 access=read-write
            enumeratedValues
              Const_00 description=0 Write No effect. Normal program line buffer operation. value=0
              Const_11 description=1 Write Invalidate the program line buffer. value=1
      PCON2 description=CPUx Program Control 2 resetvalue={Application Reset:0x0} addressOffset=37384 size=32 resetValue=0 resetMask=0
        fields
          PCACHE_SZE description=Program Cache Size ICACHE in KBytes PCACHE SZE. In KBytes lsb=0 msb=15 access=read-only
          PSCRATCH_SZE description=Program Scratch Size in KBytes PSCRATCH SZE. In KBytes lsb=16 msb=31 access=read-only
      PCON0 description=CPUx Program Control 0 resetvalue={Application Reset:0x2} addressOffset=37388 size=32 resetValue=2 resetMask=4294967295
        fields
          PCBYP description=Program Cache Bypass PCBYP lsb=1 msb=1 access=read-write
            enumeratedValues
              Const_00 description=0 Cache enabled value=0
              Const_11 description=1 Cache bypass disabled value=1

## Licence text in the file
Test license
